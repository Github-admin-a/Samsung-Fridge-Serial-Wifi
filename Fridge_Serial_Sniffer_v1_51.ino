/*
   ================================================================================
   ESP32 Fridge Monitor - Samsung SRS702GDHSS side-by-side  (v1.51)
   ================================================================================
   Board: ESP32-C3 Super Mini  (Arduino board: "ESP32C3 Dev Module")
   Tools menu: USB CDC On Boot = Enabled (for USB serial debug output)

   WHAT IT DOES:
     Listens to the fridge's GATEWAY port (blue connector on the main board),
     decodes its status messages, shows them on a web page and sends them to
     Home Assistant over MQTT (with auto-discovery). At a set interval it also
     asks the fridge for its status (the "keepalive"), which keeps the fridge
     sending data.

   WEB PAGES:
     Status        what the fridge is doing, uptime, and the recent changes
     Diagnostics   link information, captured data (hex / ASCII, downloadable)
     Serial Setup  baud rate, format, polarity, frame gap, and the keepalive
     Wi-Fi & MQTT  join a network, MQTT broker settings, forget Wi-Fi
     Settings      +/- adjustment of the fridge and freezer sensor temperatures, ice bucket delay

   THE FRIDGE PROTOCOL (9600 baud 8N1, 31-byte messages):
     byte 0..3   02 96 03 41 (header)
     byte 4      counter 0..15
     byte 5      message type: 07 = fridge status (sent when something changes,
                 and in repeated "poll bursts"), 02 = the fridge's answer to a
                 request, 05 = start-up / identity frame.
                 Requests the fridge answers: 00 and 01 (read status -> 02),
                 04 (read identity -> 05), 06 (write settings -> 02, beeps)
     byte 8      flags: 0x01 lighting, 0x02/0x04 dispenser selection, 0x08 Ice Off,
                 0x10 Child Lock, 0x20 Vacation, 0x80 Power Freeze
     byte 9      low nibble fridge set temperature index (7 - index = deg C),
                 high nibble freezer index (-(14 + index) deg C)
     byte 10     freezer temperature (top bit = minus), byte 11 fridge temperature
                 (in settings mode they show the setting instead)
     byte 12/13  raw freezer / fridge sensors (NTC thermistors, calibrated here)
     byte 16     loads: 0x80 compressor, 0x10/0x08 fridge fan, 0x40/0x20 freezer fan,
                 0x02/0x04 condenser fan
     byte 17     0x03 cooling mode, 0x04 ice dispensing, 0x20 gateway link,
                 0x40 cooling hold, 0x80 defrost heater
     byte 18     0x40 fridge door, 0x80 freezer door, 0x10 ice bucket full,
                 0x02/0x04 fridge/freezer settings mode
     byte 19     bit 0x04 toggles during poll bursts
     Not decoded yet (sent to Home Assistant as "Fridge Unknown ..."): bytes 6, 7,
     14, 15 (constant so far: 00 54 .. 14 3C), bytes 20-28 (always "000000000"),
     byte 8 bit 0x40, byte 16 bit 0x01, byte 17 bits 0x08/0x10,
     byte 18 bits 0x01/0x08/0x20, byte 19 every bit except 0x04
     byte 29     XOR of bytes 0..28, byte 30 = 00
     The fridge stops sending after a while unless something keeps asking it for
     its status. A type 00 read every 90 s fixed that (runs of 34 h and more).

   WHAT CHANGED IN v1.51:
     - The original "Fridge Ice Bucket Full" (raw on/off, as the fridge reports it)
       is back. The stabilised one is "Fridge Ice Bucket (Stabilised)", Full / Not full.
     - The ice bucket delay (default 4 min) is set on the Settings page (was the
       Calibration page, now /settings; /calibration still works).

   WHAT CHANGED IN v1.50:
     - Ice bucket: only reported Full once byte 18 bit 0x10 has been on for 4 minutes
       (ICE_FULL_MS). The ice maker's level checks set it for up to ~3 min, which
       showed as false "full" readings.
     - Home Assistant: "Fridge Ice Bucket" sensor showing Full / Not full replaces the
       on/off "Fridge Ice Bucket Full" binary sensor (removed from Home Assistant).

   WHAT CHANGED IN v1.49:
     - The rolling 24 h ice count carries on through restarts: the time of each
       batch is saved in flash (last 48 batches), not just kept in memory.
     - Fixed: after a restart the "last batch" time on the Status page showed the
       time since the restart. The last batch time is now saved too.

   WHAT CHANGED IN v1.48:
     - The ice batch total (and so "Fridge Ice Cubes Total") is saved in flash, so
       it keeps counting through restarts and power cuts instead of starting at 0.

   WHAT CHANGED IN v1.47:
     - Ice cubes: the tray makes 7 cubes per batch (ICE_CUBES_PER_FILL). New Home
       Assistant sensors "Fridge Ice Cubes (24 h)" (rolling 24 hours) and
       "Fridge Ice Cubes Total" (all time). The Status page shows batches and cubes.

   WHAT CHANGED IN v1.46:
     - Home Assistant: Fridge Lighting and Fridge Child Lock show plain On / Off.
       (Lighting was a "light" sensor, shown as Light detected / No light, and
       Child Lock was a "lock", which Home Assistant shows inverted: on = Unlocked.)

   WHAT CHANGED IN v1.45:
     - Diagnostics page: "Undecoded Bytes" table with the current value of every
       undecoded byte/bit and when it last changed, plus a log of the last 10
       undecoded changes with date and time.

   WHAT CHANGED IN v1.44:
     - Bytes and bits that are not decoded yet are sent to Home Assistant on
       <prefix>/unknown, as diagnostic entities on the Fridge Serial Monitor device:
         sensors        Fridge Unknown Byte 6, 7, 14, 15 and Bytes 20-28 (hex)
         binary sensors Fridge Unknown Byte 8 Bit 0x40, Byte 16 Bit 0x01,
                        Byte 17 Bits 0x08 / 0x10, Byte 18 Bits 0x01 / 0x08 / 0x20,
                        Byte 19 Bits 0x01 0x02 0x08 0x10 0x20 0x40 0x80
         sensor         Fridge Unknown Last Change (what moved, with a timestamp)
       Their history in Home Assistant shows when they change, to line up
       against what the fridge was doing. They are not shown on the web page.

   WHAT CHANGED IN v1.43:
     - Recent Changes: every entry starts with a short date, e.g. 28/10/26 1:15 am.

   WHAT CHANGED IN v1.42:
     - Recent Changes on a phone: shorter times (time only for today, "27 Oct"
       plus time for older entries) so they no longer run into the text.

   WHAT CHANGED IN v1.41:
     - Read-only: the type 06 set temperature test is removed. The only thing the
       ESP ever sends to the fridge is the keepalive status read (type 00).
       (The test showed the fridge beeps and acknowledges a type 06 write, but
       does not take the set temperature from byte 9.)
     - Web page fits a phone screen: the menu wraps instead of pushing the page
       sideways, and the margins are smaller on narrow screens.

   WHAT CHANGED IN v1.40:
     - Fixed: after the ESP restarted, the keepalive waited for the fridge to send
       a status frame before sending anything, which could take a long time (or
       never happen if the fridge had gone quiet). It now starts straight away
       with a built-in frame, and switches to the fridge's own frame once one
       has been seen.
     - The fridge's answers (type 02) now also fill the Status page after a
       restart, so it doesn't wait for a door opening or a poll burst.

   WHAT CHANGED IN v1.39 (a finished version of the 1.x test sketch):
     - Pages: Status, Diagnostics, Serial Setup, Wi-Fi & MQTT, Calibration.
     - Status page: no raw values or unknown bits, uptime added, run tracking
       removed. Recent Changes lists only real changes (doors, set temperatures,
       displayed temperatures, compressor, dispenser, defrost, ice maker...),
       not keepalives, poll bursts, fans or cooling mode.
     - Captured data moved to the Diagnostics page.
     - Keepalive is on by default (type 00 read, every 90 s), interval set in
       seconds on the Serial Setup page. The interval saved by v1.3x is kept.
     - New: type 06 set temperature command test (Diagnostics page).
     - Calibration: simple +/- adjustment for fridge and freezer.
     - Removed: test transmit, break, auto-probe, baud auto-detect, maintenance
       buttons, run tracking, and the raw/unknown Home Assistant entities
       (their old discovery entries are cleared when MQTT connects).
     - Temperatures stay live between poll bursts (read from the fridge's
       type 02 answers to the keepalive).

   LIBRARIES: WiFiManager (tzapu), PubSubClient, ArduinoJson (v7).

   WIRING:
     Through a bidirectional logic level converter (e.g. BSS138 board):
     - Converter LV -> 3.3V,  HV -> fridge logic voltage (MEASURE IT FIRST)
     - Converter GND (both sides) -> Board GND and Fridge GND
     - Fridge TX -> HV1 -> LV1 -> GPIO 20 (labelled "RX" / "20")
     - GPIO 7    -> LV2 -> HV2 -> Fridge RX
     - Do NOT use GPIO 21 (labelled "TX") for TX: the chip prints boot
       messages on it at every reset, which would go to the fridge.
     - SAFETY: many appliance control boards are NOT isolated from mains, so
       their "GND" can be live. Check before connecting, and do not have the
       ESP32 plugged into a PC by USB while it is wired to the fridge unless
       you know the port is isolated. Power it from the fridge's own low
       voltage rail or an isolated supply and use the web page / OTA.
   ================================================================================
*/

#include <WiFi.h>
#include <WebServer.h>
#include <WiFiManager.h>
#include <ArduinoOTA.h>
#include <ESPmDNS.h>
#include <Preferences.h>
#include <PubSubClient.h>
#include <ArduinoJson.h>
#include "driver/gpio.h"
#include <esp_system.h>
#include <esp_timer.h>
#include <time.h>

#define CHG_N   25          // changes kept for the web page
#define CHG_TXT 200         // max text length of one change record
struct ChangeRec { uint32_t ms; uint32_t ep; char txt[CHG_TXT]; };

// --------------------------------------------------------------------------------
// HARDWARE CONFIGURATION
// --------------------------------------------------------------------------------
// Wi-Fi transmit power. 8.5 dBm is a workaround for Super Mini boards that fail to
// join at higher power (15 dBm made this board drop off the network).
#define WIFI_TX_POWER WIFI_POWER_8_5dBm

#define FW_VERSION    "1.51"    // shown in the web page header and on USB serial
#define RX_PIN        20        // GPIO 20 (labelled RX on the ESP32-C3 Super Mini)
#define TX_PIN        7         // GPIO 7 (quiet at boot; GPIO 21 is not used)
#define FRAME_MAX     64        // max bytes shown per line (longer bursts wrap)
#define LOG_FRAMES    80        // frames kept in RAM for the Diagnostics page

HardwareSerial& hwSerial = Serial1;
WebServer server(80);
Preferences prefs;
WiFiManager wm;
bool netStarted = false;        // true once WiFi is up and our web server is running
void startNetServices();

// --------------------------------------------------------------------------------
// SERIAL FORMAT TABLE (index is what the web page sends)
// --------------------------------------------------------------------------------
const uint32_t FORMAT_CFG[] = { SERIAL_8N1, SERIAL_8E1, SERIAL_8O1, SERIAL_7E1, SERIAL_7O1, SERIAL_8N2 };
const uint8_t  FORMAT_COUNT = sizeof(FORMAT_CFG) / sizeof(FORMAT_CFG[0]);

// --------------------------------------------------------------------------------
// PERSISTENT SETTINGS
// --------------------------------------------------------------------------------
uint32_t cfgBaud   = 9600;
uint8_t  cfgFmt    = 0;         // index into FORMAT_CFG (0 = 8N1)
bool     cfgInvert = false;
uint32_t cfgGapMs  = 30;        // bus silence that ends a captured line
bool     cfgKaEn   = true;      // keepalive on / off
uint16_t cfgKaSec  = 90;        // keepalive interval in seconds

// --------------------------------------------------------------------------------
// CAPTURE LOG (ring buffer, shown on the Diagnostics page)
// --------------------------------------------------------------------------------
struct Frame {
  uint32_t ms;
  uint16_t len;
  uint8_t  data[FRAME_MAX];
};
Frame    logBuf[LOG_FRAMES];
uint32_t nextSeq  = 1;          // sequence number of the next frame to be stored
uint32_t firstSeq = 1;          // oldest sequence number still valid (moves on Clear)
uint32_t epoch    = 0;          // bumps whenever settings change / log is cleared

uint8_t  curBuf[FRAME_MAX];
uint16_t curLen = 0;
uint32_t curStartMs = 0;
uint32_t lastRxMs = 0;
uint32_t totalBytes = 0;

volatile uint32_t errFrame = 0, errParity = 0, errBreak = 0, errOverflow = 0;
// Signal monitor (reads the pin directly, independent of the UART)
uint32_t rxByteCount = 0;         // bytes received since boot (never cleared)
uint32_t lastByteMs = 0;
bool     anyByte = false;
int      lineLevel = 1;
uint32_t lineEdges = 0;           // level changes seen by polling the pin
uint32_t lastLineEdgeMs = 0;
bool     anyEdge = false;
uint32_t portFixes = 0;           // automatic restarts because signal was present but no bytes

const char* resetReasonText() {
  switch (esp_reset_reason()) {
    case ESP_RST_POWERON:  return "Power-on";
    case ESP_RST_SW:       return "Software restart";
    case ESP_RST_PANIC:    return "Crash";
    case ESP_RST_INT_WDT:
    case ESP_RST_TASK_WDT:
    case ESP_RST_WDT:      return "Watchdog";
    case ESP_RST_BROWNOUT: return "Brownout (supply voltage dipped)";
    case ESP_RST_EXT:      return "Reset pin";
    case ESP_RST_DEEPSLEEP:return "Deep sleep wake";
    default:               return "Other";
  }
}

volatile bool uartNeedsRestart = false;   // set after a buffer overflow
uint32_t uartRestarts = 0;

// --------------------------------------------------------------------------------
// MQTT SETTINGS & OBJECTS
// --------------------------------------------------------------------------------
char mqtt_server[64] = "";
int  mqtt_port       = 1883;
char mqtt_user[32]   = "";
char mqtt_pass[32]   = "";
char mqtt_topic[64]  = "homeassistant/sensor/fridge";

WiFiClient   espClient;
PubSubClient mqttClient(espClient);
unsigned long lastMQTTAttempt = 0;
bool mqttDirty = false;         // a new fridge state is waiting to be published
uint16_t cfgStaleMin = 30;      // minutes without a fridge message before data counts as stale (0 = never)
int8_t   lastPubStale = -1;     // last data_status published (-1 = not yet)

// --------------------------------------------------------------------------------
// CLOCK (internet time, used to timestamp changes)
// --------------------------------------------------------------------------------
bool clockValid() { return time(nullptr) > 1700000000; }
uint32_t epochNow() { return (uint32_t)time(nullptr); }
uint32_t uptimeSec() { return (uint32_t)(esp_timer_get_time() / 1000000ULL); }

String isoUtc(uint32_t e) {
  if (!e) return String("");
  time_t t = e; struct tm g; gmtime_r(&t, &g);
  char b[32]; strftime(b, sizeof(b), "%Y-%m-%dT%H:%M:%S+00:00", &g);
  return String(b);
}

// --------------------------------------------------------------------------------
// FRIDGE MESSAGE DECODER
//   Message = 31 bytes: 02 96 .... [29]=XOR of bytes 0..28, [30]=00
// --------------------------------------------------------------------------------
#define MSG_LEN 31
uint8_t  msgWin[MSG_LEN];       // sliding window over the incoming byte stream
uint8_t  lastMsg[MSG_LEN];      // most recent valid status message (type 07)
bool     haveMsg = false;
uint32_t lastMsgMs = 0;         // last valid message of any type
uint8_t  live12 = 0, live13 = 0;   // sensor bytes from the latest type 02 answer
uint32_t liveMs = 0;               // when that answer arrived (0 = none yet)
uint32_t last07Ms = 0;             // when the latest status frame (type 07) arrived
uint32_t badCount = 0;          // messages with a checksum failure
uint32_t lastAnswerMs = 0;      // last type 02 answer from the fridge
uint32_t kaSent = 0, kaLastSent = 0;   // keepalives sent, and when the last one went out
uint32_t kaLastTickMs = 0;
uint8_t  lastCounter = 0;       // byte 4 of the latest valid frame of any type
// Built-in status frame for the keepalive, used until the fridge has sent its own
const uint8_t KA_DEFAULT[31] = {0x02,0x96,0x03,0x41,0x00,0x07,0x00,0x54,0x00,0x24,0x90,0x03,0xBA,0x7A,0x14,0x3C,
  0xB2,0x21,0x00,0x00,0x30,0x30,0x30,0x30,0x30,0x30,0x30,0x30,0x30,0x00,0x00};
uint32_t lastPubMs = 0;         // MQTT rate limiting
uint8_t  lastPubB18 = 0, lastPubB16 = 0, lastPubB8 = 0, lastPubB17 = 0;
int      fridgeTemp = 0;        // last fridge temperature seen outside settings mode
bool     haveFridgeTemp = false;
int      freezerTemp = 0;       // last freezer temperature seen outside freezer settings mode
bool     haveFreezerTemp = false;

// Dispenser selection (byte 8)
const char* dispenserMode(uint8_t b) {
  switch (b & 0x06) {               // bits 0x02 (water) and 0x04 (cubed) only
    case 0x00: return "Crushed ice";
    case 0x04: return "Cubed ice";
    default:   return "Water";      // 0x02 / 0x06: water (reached from either ice type)
  }
}

// What the dispenser is putting out right now (byte 17 0x04 + ice type in byte 8)
const char* dispensingText(const uint8_t* m) {
  if (!(m[17] & 0x04)) return "Off";
  switch (m[8] & 0x06) {
    case 0x00: return "Crushed ice";
    case 0x04: return "Cubed ice";
    default:   return "Ice";
  }
}

// Byte 17 low 2 bits: what is being cooled
const char* coolMode(uint8_t b17) {
  switch (b17 & 0x03) {
    case 0: return "Idle";
    case 1: return "Fridge";
    case 2: return "Freezer";
    default: return "Both";
  }
}

int smTemp(uint8_t b) { return (b & 0x80) ? -(int)(b & 0x7F) : (int)b; }

// Set temperatures from byte 9
int fridgeSetFromB9(uint8_t b9, bool& ok) { int a = b9 & 0x0F; ok = (a <= 6); return 7 - a; }
int freezerSetFromB9(uint8_t b9, bool& ok) { int a = b9 >> 4; ok = (a <= 11); return -(14 + a); }

// --------------------------------------------------------------------------------
// TEMPERATURES FROM THE RAW SENSOR BYTES
//   Fridge air  = A - S x byte 13  (calibrated against an Inkbird logger)
//   Freezer     = NTC model of byte 12 (same thermistor type, estimate)
//   Plus the adjustment set on the Calibration page.
// --------------------------------------------------------------------------------
float calA = 44.6f, calS = 0.31f;       // fixed fridge conversion (from the earlier calibration)
float offFridge = 0.0f;                 // Calibration page: fridge adjustment (C)
float offFreezer = 0.0f;                // Calibration page: freezer adjustment (C)
#define TAVG_N 60                       // 60 one-second samples
uint8_t  tSamp12[TAVG_N], tSamp13[TAVG_N];
uint8_t  tSampN = 0, tSampPos = 0;
float    airTemp = NAN, frzTemp = NAN;  // averaged, calibrated
float    lastPubAir = NAN, lastPubFrz = NAN;
float frzFromRaw(float c) {
  if (c < 1) c = 1;
  if (c > 254) c = 254;
  float x = c / (255.0f - c);           // thermistor / divider resistor
  float invT = 1.0f / 298.15f + logf(x / 0.39f) / 3920.0f;
  return 1.0f / invT - 273.15f + offFreezer;
}

// --------------------------------------------------------------------------------
// RECENT CHANGES: only things worth knowing about, described in words
// --------------------------------------------------------------------------------
ChangeRec chgLog[CHG_N];
uint32_t  chgSeq = 0;       // changes recorded since boot
uint32_t  chgPubSeq = 0;    // changes already sent to MQTT

static void chgAdd(String& s, const String& part) { if (s.length()) s += "; "; s += part; }
static String hx2(uint8_t v) { char b[6]; snprintf(b, sizeof b, "0x%02X", v); return String(b); }

// Bytes and bits not decoded yet. They are sent to Home Assistant (<prefix>/unknown)
// but kept off the web page and out of Recent Changes.
struct UnkBit { uint8_t i; uint8_t mask; };
const UnkBit  UNK_BITS[]  = {{8, 0x40}, {16, 0x01}, {17, 0x08}, {17, 0x10}, {18, 0x01}, {18, 0x08}, {18, 0x20},
                             {19, 0x01}, {19, 0x02}, {19, 0x08}, {19, 0x10}, {19, 0x20}, {19, 0x40}, {19, 0x80}};
const uint8_t UNK_BYTES[] = {6, 7, 14, 15};
#define UNK_FIRST 20                    // bytes 20..28 are reported together
#define UNK_LAST  28
String   unkLastChange;                 // what last changed, in words
uint32_t unkLastEp = 0;                 // when (epoch seconds, 0 = clock not set)
bool     unkDirty = true;               // something changed: publish /unknown

// When each undecoded item last changed (index: bytes, then bytes 20-28, then bits)
const uint8_t UNK_NBYTES = sizeof(UNK_BYTES);
const uint8_t UNK_NBITS  = sizeof(UNK_BITS) / sizeof(UNK_BITS[0]);
const uint8_t UNK_N      = UNK_NBYTES + 1 + UNK_NBITS;
uint32_t unkChgMs[UNK_N];               // millis() of the last change (0 = none since restart)
uint32_t unkChgEp[UNK_N];               // epoch seconds of the last change (0 = clock not set / none)
// Log of the last undecoded changes, for the Diagnostics page
#define UNK_LOG_N 10
ChangeRec unkLog[UNK_LOG_N];
uint32_t  unkLogSeq = 0;

static void unkMark(uint8_t idx) {
  unkChgMs[idx] = millis() ? millis() : 1;
  unkChgEp[idx] = clockValid() ? epochNow() : 0;
}

void recordUnknown(const uint8_t* o, const uint8_t* n) {
  String s;
  for (uint8_t k = 0; k < UNK_NBYTES; k++) {
    uint8_t i = UNK_BYTES[k];
    if (o[i] != n[i]) { chgAdd(s, "Byte " + String(i) + ": " + hx2(o[i]) + " -> " + hx2(n[i])); unkMark(k); }
  }
  for (uint8_t i = UNK_FIRST; i <= UNK_LAST; i++)
    if (o[i] != n[i]) { chgAdd(s, "Byte " + String(i) + ": " + hx2(o[i]) + " -> " + hx2(n[i])); unkMark(UNK_NBYTES); }
  for (uint8_t k = 0; k < UNK_NBITS; k++) {
    const UnkBit& u = UNK_BITS[k];
    if ((o[u.i] ^ n[u.i]) & u.mask) {
      chgAdd(s, "Byte " + String(u.i) + " bit " + hx2(u.mask) + ((n[u.i] & u.mask) ? " on" : " off"));
      unkMark(UNK_NBYTES + 1 + k);
    }
  }
  if (s.length() == 0) return;
  unkLastChange = s;
  unkLastEp = clockValid() ? epochNow() : 0;
  unkDirty = true;
  ChangeRec& c = unkLog[unkLogSeq % UNK_LOG_N];
  c.ms = millis();
  c.ep = unkLastEp;
  strncpy(c.txt, s.c_str(), CHG_TXT - 1);
  c.txt[CHG_TXT - 1] = 0;
  unkLogSeq++;
  Serial.printf("Unknown change: %s\n", s.c_str());
}

void chgPush(const String& s) {
  ChangeRec& c = chgLog[chgSeq % CHG_N];
  c.ms  = millis();
  c.ep  = clockValid() ? epochNow() : 0;
  strncpy(c.txt, s.c_str(), CHG_TXT - 1);
  c.txt[CHG_TXT - 1] = 0;
  chgSeq++;
  Serial.printf("Change: %s\n", c.txt);
}

void recordChange(const uint8_t* o, const uint8_t* n) {
  String s;
  // Byte 8: dispenser selection and the on/off settings
  {
    uint8_t d = o[8] ^ n[8];
    if ((d & 0x06) && strcmp(dispenserMode(o[8]), dispenserMode(n[8])) != 0)
      chgAdd(s, String("Dispenser: ") + dispenserMode(o[8]) + " -> " + dispenserMode(n[8]));
    if (d & 0x80) chgAdd(s, (n[8] & 0x80) ? "Power Freeze on" : "Power Freeze off");
    if (d & 0x08) chgAdd(s, (n[8] & 0x08) ? "Ice Off on" : "Ice Off off (ice maker on)");
    if (d & 0x01) chgAdd(s, (n[8] & 0x01) ? "Lighting on" : "Lighting off");
    if (d & 0x10) chgAdd(s, (n[8] & 0x10) ? "Child Lock on" : "Child Lock off");
    if (d & 0x20) chgAdd(s, (n[8] & 0x20) ? "Vacation mode on" : "Vacation mode off");
  }
  // Byte 9: set temperatures
  if ((o[9] & 0x0F) != (n[9] & 0x0F)) {
    bool a, b;
    int x = fridgeSetFromB9(o[9], a), y = fridgeSetFromB9(n[9], b);
    chgAdd(s, "Fridge set temperature: " + (a ? String(x) : String("?")) + " -> " + (b ? String(y) : String("?")) + " C");
  }
  if ((o[9] >> 4) != (n[9] >> 4)) {
    bool a, b;
    int x = freezerSetFromB9(o[9], a), y = freezerSetFromB9(n[9], b);
    chgAdd(s, "Freezer set temperature: " + (a ? String(x) : String("?")) + " -> " + (b ? String(y) : String("?")) + " C");
  }
  // Bytes 10 / 11: displayed temperatures (they show the setting while in settings mode)
  if (o[10] != n[10] && !((o[18] | n[18]) & 0x04))
    chgAdd(s, "Freezer temperature: " + String(smTemp(o[10])) + " -> " + String(smTemp(n[10])) + " C");
  if (o[11] != n[11] && !((o[18] | n[18]) & 0x02))
    chgAdd(s, "Fridge temperature: " + String(smTemp(o[11])) + " -> " + String(smTemp(n[11])) + " C");
  // Byte 16: compressor
  if ((o[16] ^ n[16]) & 0x80) chgAdd(s, (n[16] & 0x80) ? "Compressor started" : "Compressor stopped");
  // Byte 17: dispenser, defrost, cooling hold, gateway link
  if ((o[17] ^ n[17]) & 0x04) {
    String what = (n[17] & 0x04) ? dispensingText(n) : dispensingText(o);
    what.toLowerCase();
    chgAdd(s, String((n[17] & 0x04) ? "Dispensing " : "Stopped dispensing ") + what);
  }
  if ((o[17] ^ n[17]) & 0x80) chgAdd(s, (n[17] & 0x80) ? "Defrost heater on" : "Defrost heater off");
  if ((o[17] ^ n[17]) & 0x40) chgAdd(s, (n[17] & 0x40) ? "Cooling hold on" : "Cooling hold off");
  if ((o[17] ^ n[17]) & 0x20) chgAdd(s, (n[17] & 0x20) ? "Gateway link on" : "Gateway link off");
  // Byte 18: doors, ice bucket
  {
    uint8_t d = o[18] ^ n[18];
    if (d & 0x40) chgAdd(s, (n[18] & 0x40) ? "Fridge door opened" : "Fridge door closed");
    if (d & 0x80) chgAdd(s, (n[18] & 0x80) ? "Freezer door opened" : "Freezer door closed");
  }
  if (s.length() == 0) return;          // only fans, counters and other minor bytes changed
  chgPush(s);
}

// --------------------------------------------------------------------------------
// ICE MAKER FILL DETECTION
//   While the ice tray fills, the freezer fan (byte 16 0x40/0x20) stops for
//   ~36 s with the compressor on (0x80), doors shut and no defrost/hold.
// --------------------------------------------------------------------------------
#define ICE_HIST 48
uint16_t cfgIceFullSec = 240;          // "ice bucket full" must stay on this long to count (Settings page):
                                       // the ice maker's level checks set it for up to ~3 min
#define ICE_CUBES_PER_FILL 7           // cubes the ice tray makes per batch
// Recent fills (ring). The times are saved in flash so the rolling 24 h count
// carries on through restarts. A fill made before the clock was set has
// iceFillEp = 0 and is timed by millis() until the clock is set (iceClockFix).
uint32_t iceFillEp[ICE_HIST];          // epoch seconds of recent fills (0 = not known yet)
uint32_t iceFillMs[ICE_HIST];          // millis() of fills since this restart (0 = from before)
uint8_t  iceFillN = 0, iceFillPos = 0;
uint32_t iceFillTotal = 0;             // all-time batches (saved in flash)
uint32_t iceFillLastMs = 0, iceFillLastEp = 0;
bool     icePause = false, icePauseOk = false;
uint32_t icePauseStartMs = 0;

void saveIce() {
  prefs.begin("ice", false);
  prefs.putUInt("total", iceFillTotal);
  prefs.putUInt("last", iceFillLastEp);
  prefs.putUChar("n", iceFillN);
  prefs.putUChar("pos", iceFillPos);
  prefs.putBytes("eps", iceFillEp, sizeof(iceFillEp));
  prefs.end();
}

void loadIce() {
  prefs.begin("ice", true);
  iceFillTotal  = prefs.getUInt("total", 0);
  iceFillLastEp = prefs.getUInt("last", 0);
  iceFillN      = prefs.getUChar("n", 0);
  iceFillPos    = prefs.getUChar("pos", 0);
  if (prefs.getBytesLength("eps") != sizeof(iceFillEp)) iceFillN = 0;
  else prefs.getBytes("eps", iceFillEp, sizeof(iceFillEp));
  prefs.end();
  if (iceFillN > ICE_HIST || iceFillPos >= ICE_HIST) { iceFillN = 0; iceFillPos = 0; }
  memset(iceFillMs, 0, sizeof(iceFillMs));
}

// Once the clock is set, give a real time to fills made before that, and save them
void iceClockFix() {
  if (!clockValid()) return;
  bool changed = false;
  for (uint8_t i = 0; i < iceFillN; i++)
    if (!iceFillEp[i] && iceFillMs[i]) { iceFillEp[i] = epochNow() - (millis() - iceFillMs[i]) / 1000; changed = true; }
  if (!iceFillLastEp && iceFillLastMs) { iceFillLastEp = epochNow() - (millis() - iceFillLastMs) / 1000; changed = true; }
  if (changed) { saveIce(); mqttDirty = true; }
}

// Ice bucket full, ignoring the short level checks (byte 18 bit 0x10 on for under 4 min)
bool     iceRawFull = false, iceFull = false;
uint32_t iceRawOnMs = 0;
void iceBucketTick() {
  if (!haveMsg) return;
  bool raw = lastMsg[18] & 0x10;
  if (raw && !iceRawFull) iceRawOnMs = millis();
  iceRawFull = raw;
  bool full = raw && millis() - iceRawOnMs >= (uint32_t)cfgIceFullSec * 1000UL;
  if (full != iceFull) {
    iceFull = full;
    chgPush(full ? "Ice bucket full" : "Ice bucket not full");
    mqttDirty = true;
  }
}

uint16_t iceFills24h() {
  uint16_t c = 0;
  bool cv = clockValid();
  uint32_t now = cv ? epochNow() : 0;
  for (uint8_t i = 0; i < iceFillN; i++) {
    if (iceFillEp[i]) { if (cv && now - iceFillEp[i] < 86400UL) c++; }
    else if (iceFillMs[i] && millis() - iceFillMs[i] < 86400000UL) c++;
  }
  return c;
}

// Called for every new (changed) status message
void iceFillCheck(const uint8_t* o, const uint8_t* n) {
  bool fzWas = o[16] & 0x60, fzNow = n[16] & 0x60;
  bool okNow = (n[16] & 0x80) && !(n[18] & 0xC0) && !(n[17] & 0xC0);
  if (fzWas && !fzNow) {                      // freezer fan just stopped
    icePause = true;
    icePauseOk = okNow;
    icePauseStartMs = millis();
  } else if (icePause && !fzNow) {
    if (!okNow) icePauseOk = false;           // door, compressor off or defrost
  } else if (icePause && fzNow) {              // fan back on
    icePause = false;
    uint32_t d = millis() - icePauseStartMs;
    if (icePauseOk && d >= 25000 && d <= 50000) {
      iceFillMs[iceFillPos] = millis() ? millis() : 1;
      iceFillEp[iceFillPos] = clockValid() ? epochNow() : 0;
      iceFillPos = (iceFillPos + 1) % ICE_HIST;
      if (iceFillN < ICE_HIST) iceFillN++;
      iceFillTotal++;
      iceFillLastMs = millis() ? millis() : 1;
      iceFillLastEp = clockValid() ? epochNow() : 0;
      saveIce();                                // kept through restarts
      chgPush("Ice maker fill");
      mqttDirty = true;
    }
  }
}

// Called for every incoming byte: finds valid 31-byte messages in the stream
void feedDecoder(uint8_t b) {
  memmove(msgWin, msgWin + 1, MSG_LEN - 1);
  msgWin[MSG_LEN - 1] = b;
  if (msgWin[0] != 0x02 || msgWin[1] != 0x96 || msgWin[MSG_LEN - 1] != 0x00) return;
  uint8_t x = 0;
  for (uint8_t i = 0; i < MSG_LEN - 2; i++) x ^= msgWin[i];
  if (x != msgWin[MSG_LEN - 2]) { badCount++; return; }
  lastMsgMs = millis();
  lastCounter = msgWin[4];
  // Not a status message (byte 5 = 0x07): answers to our requests, start-up frame
  if (msgWin[5] != 0x07) {
    if (msgWin[5] == 0x02) {
      // The fridge's answer to a request carries live sensor bytes 12/13
      lastAnswerMs = millis();
      live12 = msgWin[12]; live13 = msgWin[13]; liveMs = millis();
      // No status frame since the restart yet: the answer has the same layout, so use it
      if (!haveMsg) {
        memcpy(lastMsg, msgWin, MSG_LEN);
        lastMsg[5] = 0x07;
        uint8_t c = 0; for (uint8_t i = 0; i < MSG_LEN - 2; i++) c ^= lastMsg[i];
        lastMsg[MSG_LEN - 2] = c;
        if (!(lastMsg[18] & 0x02)) { fridgeTemp = smTemp(lastMsg[11]); haveFridgeTemp = true; }
        if (!(lastMsg[18] & 0x04)) { freezerTemp = smTemp(lastMsg[10]); haveFreezerTemp = true; }
        haveMsg = true;
        mqttDirty = true;
      }
    }
    return;
  }
  last07Ms = millis();
  // Byte 11 shows the 1-7 setting instead of the temperature in settings mode
  if (!(msgWin[18] & 0x02)) { fridgeTemp = smTemp(msgWin[11]); haveFridgeTemp = true; }
  // Byte 10 shows the freezer SET temperature while freezer settings mode is on
  if (!(msgWin[18] & 0x04)) { freezerTemp = smTemp(msgWin[10]); haveFreezerTemp = true; }
  if (!haveMsg || memcmp(msgWin, lastMsg, MSG_LEN) != 0) {
    if (haveMsg) { recordChange(lastMsg, msgWin); recordUnknown(lastMsg, msgWin); iceFillCheck(lastMsg, msgWin); }
    memcpy(lastMsg, msgWin, MSG_LEN);
    haveMsg = true;
    mqttDirty = true;
  }
}

// ESP32 replacement for ESP.getChipId(): last 3 bytes of the MAC address
String getChipIdHex() {
  uint32_t chipId = 0;
  for (int i = 0; i < 17; i += 8) {
    chipId |= ((ESP.getEfuseMac() >> (40 - i)) & 0xff) << i;
  }
  return String(chipId, HEX);
}

// Escapes a string for safe use inside a JSON string value
String jsonEsc(const char* in) {
  String out;
  for (const char* p = in; *p; p++) {
    if (*p == '"' || *p == '\\') { out += '\\'; out += *p; }
    else if ((uint8_t)*p >= 0x20) out += *p;
  }
  return out;
}

String msgHex() {
  static const char H[] = "0123456789ABCDEF";
  String out;
  if (!haveMsg) return out;
  out.reserve(MSG_LEN * 2);
  for (uint8_t i = 0; i < MSG_LEN; i++) {
    out += H[lastMsg[i] >> 4];
    out += H[lastMsg[i] & 0x0F];
  }
  return out;
}

// --------------------------------------------------------------------------------
// SERIAL PORT
// --------------------------------------------------------------------------------
void onUartError(hardwareSerial_error_t e) {
  switch (e) {
    case UART_FRAME_ERROR:       errFrame++;    break;
    case UART_PARITY_ERROR:      errParity++;   break;
    case UART_BREAK_ERROR:       errBreak++;    break;
    case UART_FIFO_OVF_ERROR:
    case UART_BUFFER_FULL_ERROR: errOverflow++; uartNeedsRestart = true; break;
    default: break;
  }
}

void beginFridgeSerial() {
  hwSerial.setRxBufferSize(4096);         // must be set before begin()
  hwSerial.begin(cfgBaud, FORMAT_CFG[cfgFmt], RX_PIN, TX_PIN, cfgInvert);
  hwSerial.setRxFIFOFull(1);              // hand over each byte as it arrives
  // The serial driver turns on a weak (~45k) pull-up to 3.3V on the RX pin.
  // Switch it off so the only thing touching the fridge's line is the converter.
  gpio_pullup_dis((gpio_num_t)RX_PIN);
  gpio_pulldown_dis((gpio_num_t)RX_PIN);
  hwSerial.onReceiveError(onUartError);
}

void clearLog() {
  curLen = 0;
  firstSeq = nextSeq;
  totalBytes = 0;
  errFrame = errParity = errBreak = errOverflow = 0;
  epoch++;
}

void restartCapture() {
  hwSerial.end();
  beginFridgeSerial();
  memset(msgWin, 0xFF, sizeof(msgWin));
  clearLog();
}

void flushFrame() {
  if (curLen == 0) return;
  Frame& f = logBuf[nextSeq % LOG_FRAMES];
  f.ms  = curStartMs;
  f.len = curLen;
  memcpy(f.data, curBuf, curLen);
  nextSeq++;
  curLen = 0;
}

// --------------------------------------------------------------------------------
// SETTINGS STORAGE
// --------------------------------------------------------------------------------
void loadSettings() {
  prefs.begin("fridge", true);
  cfgBaud   = prefs.getUInt("baud", 9600);
  cfgFmt    = prefs.getUChar("fmt", 0);
  cfgInvert = prefs.getBool("inv", false);
  cfgGapMs  = prefs.getUInt("gap", 30);
  strlcpy(mqtt_server, prefs.getString("mhost", "").c_str(), sizeof(mqtt_server));
  mqtt_port = prefs.getInt("mport", 1883);
  strlcpy(mqtt_user, prefs.getString("muser", "").c_str(), sizeof(mqtt_user));
  strlcpy(mqtt_pass, prefs.getString("mpass", "").c_str(), sizeof(mqtt_pass));
  strlcpy(mqtt_topic, prefs.getString("mtopic", "homeassistant/sensor/fridge").c_str(), sizeof(mqtt_topic));
  cfgStaleMin = prefs.getUShort("stalemin", 30);
  prefs.end();
  if (mqtt_port <= 0 || mqtt_port > 65535) mqtt_port = 1883;
  if (strlen(mqtt_topic) == 0) strlcpy(mqtt_topic, "homeassistant/sensor/fridge", sizeof(mqtt_topic));
  if (cfgFmt >= FORMAT_COUNT) cfgFmt = 0;
  if (cfgBaud < 50 || cfgBaud > 1000000) cfgBaud = 9600;
  if (cfgGapMs < 2 || cfgGapMs > 10000) cfgGapMs = 30;
}

void saveSettings() {
  prefs.begin("fridge", false);
  prefs.putUInt("baud", cfgBaud);
  prefs.putUChar("fmt", cfgFmt);
  prefs.putBool("inv", cfgInvert);
  prefs.putUInt("gap", cfgGapMs);
  prefs.putString("mhost", mqtt_server);
  prefs.putInt("mport", mqtt_port);
  prefs.putString("muser", mqtt_user);
  prefs.putString("mpass", mqtt_pass);
  prefs.putString("mtopic", mqtt_topic);
  prefs.putUShort("stalemin", cfgStaleMin);
  prefs.end();
}

// Keepalive settings. The first time, the interval saved by the earlier test
// sketches (under "autotx") is taken over, so a 90 s keepalive carries on as it was.
void loadKeepalive() {
  prefs.begin("keepalive", true);
  bool have = prefs.isKey("sec");
  cfgKaEn  = prefs.getBool("en", true);
  cfgKaSec = prefs.getUShort("sec", 90);
  prefs.end();
  if (!have) {
    prefs.begin("autotx", true);
    if (prefs.isKey("kasec")) cfgKaSec = prefs.getUShort("kasec", 90);
    prefs.end();
    cfgKaEn = true;                         // the keepalive is what keeps the fridge talking
  }
  if (cfgKaSec < 2 || cfgKaSec > 3600) cfgKaSec = 90;
}

void saveKeepalive() {
  prefs.begin("keepalive", false);
  prefs.putBool("en", cfgKaEn);
  prefs.putUShort("sec", cfgKaSec);
  prefs.end();
}

void loadCal() {
  prefs.begin("cal", true);
  calA       = prefs.getFloat("a", 44.6f);       // fixed conversion from the earlier calibration
  calS       = prefs.getFloat("s", 0.31f);
  offFreezer = prefs.getFloat("f", 0.0f);         // freezer adjustment (was the freezer offset)
  offFridge  = prefs.getFloat("o", 0.0f);         // fridge adjustment
  prefs.end();
  if (calS <= 0 || calS > 5) { calA = 44.6f; calS = 0.31f; }
  if (offFridge < -5 || offFridge > 5) offFridge = 0;
  if (offFreezer < -5 || offFreezer > 5) offFreezer = 0;
}

// True when no fridge message has arrived within the stale time (or none yet)
bool dataIsStale() {
  if (!haveMsg) return true;
  if (cfgStaleMin == 0) return false;
  return (millis() - lastMsgMs) > (uint32_t)cfgStaleMin * 60000UL;
}

void publishDataStatus() {
  bool st = dataIsStale();
  String t = String(mqtt_topic) + "/data_status";
  mqttClient.publish(t.c_str(), st ? "offline" : "online", true);
  lastPubStale = st ? 1 : 0;
}

// --------------------------------------------------------------------------------
// MQTT: STATE PUBLISHER
// --------------------------------------------------------------------------------
void publishState() {
  if (!haveMsg || !mqttClient.connected()) return;
  const uint8_t* m = lastMsg;

  JsonDocument doc;
  doc["fridge_door"]   = (m[18] & 0x40) != 0;
  doc["freezer_door"]  = (m[18] & 0x80) != 0;
  doc["settings_mode"] = (m[18] & 0x06) != 0;   // 0x02 fridge, 0x04 freezer
  bool ok;
  int fz = freezerSetFromB9(m[9], ok);
  if (ok) doc["freezer_set_temp"] = fz; else doc["freezer_set_temp"] = nullptr;
  int fr = fridgeSetFromB9(m[9], ok);
  if (ok) doc["fridge_set_temp"] = fr; else doc["fridge_set_temp"] = nullptr;
  if (haveFridgeTemp) doc["fridge_temp"] = fridgeTemp;
  else                doc["fridge_temp"] = nullptr;
  if (haveFreezerTemp) doc["freezer_temp"] = freezerTemp;
  else                 doc["freezer_temp"] = nullptr;
  if (!isnan(airTemp)) doc["fridge_air_temp"] = roundf(airTemp * 10) / 10.0f;
  else                  doc["fridge_air_temp"] = nullptr;
  if (!isnan(frzTemp)) doc["freezer_est_temp"] = roundf(frzTemp * 10) / 10.0f;
  else                  doc["freezer_est_temp"] = nullptr;
  lastPubAir = airTemp; lastPubFrz = frzTemp;
  doc["dispenser_selection"] = dispenserMode(m[8]);
  doc["power_freeze"] = (m[8] & 0x80) != 0;
  doc["ice_off"]      = (m[8] & 0x08) != 0;
  doc["lighting"]     = (m[8] & 0x01) != 0;
  doc["child_lock"]   = (m[8] & 0x10) != 0;
  doc["vacation"]     = (m[8] & 0x20) != 0;
  doc["dispenser_active"] = (m[17] & 0x04) != 0;   // ice dispensing
  doc["dispensing"]   = dispensingText(m);
  doc["compressor"]   = (m[16] & 0x80) != 0;
  doc["fridge_fan"]   = (m[16] & 0x18) != 0;   // 0x10 or 0x08 (2nd speed)
  doc["freezer_fan"]  = (m[16] & 0x60) != 0;   // 0x40 or 0x20 (2nd speed)
  doc["cooling_mode"] = coolMode(m[17]);
  doc["ice_bucket_full"] = (m[18] & 0x10) != 0;          // raw, as the fridge reports it
  doc["ice_bucket"]      = iceFull ? "Full" : "Not full";   // stabilised
  doc["defrost"]      = (m[17] & 0x80) != 0;
  doc["cooling_hold"] = (m[17] & 0x40) != 0;
  doc["ice_fills_24h"]   = iceFills24h();
  doc["ice_fills_total"] = iceFillTotal;
  doc["ice_cubes_24h"]   = iceFills24h() * ICE_CUBES_PER_FILL;
  doc["ice_cubes_total"] = iceFillTotal * ICE_CUBES_PER_FILL;   // all time (saved in flash)
  if (iceFillLastEp) doc["last_ice_fill"] = isoUtc(iceFillLastEp); else doc["last_ice_fill"] = nullptr;
  doc["uptime_s"]     = uptimeSec();
  doc["ip"]           = WiFi.localIP().toString();

  String payload;
  serializeJson(doc, payload);
  String stateTopic = String(mqtt_topic) + "/state";
  mqttClient.publish(stateTopic.c_str(), payload.c_str(), true);
  lastPubMs    = millis();
  lastPubB18   = m[18];
  lastPubB16   = m[16];
  lastPubB8    = m[8];
  lastPubB17   = m[17];
}

// Sends the undecoded bytes and bits to <prefix>/unknown (retained)
void publishUnknown() {
  if (!haveMsg || !mqttClient.connected()) return;
  const uint8_t* m = lastMsg;
  JsonDocument doc;
  for (uint8_t i : UNK_BYTES) { char k[8]; snprintf(k, sizeof k, "b%u", i); doc[k] = hx2(m[i]); }
  String b20;
  for (uint8_t i = UNK_FIRST; i <= UNK_LAST; i++) { char h[4]; snprintf(h, sizeof h, i > UNK_FIRST ? " %02X" : "%02X", m[i]); b20 += h; }
  doc["b20_28"] = b20;
  for (const UnkBit& u : UNK_BITS) { char k[12]; snprintf(k, sizeof k, "b%u_%02x", u.i, u.mask); doc[k] = (m[u.i] & u.mask) != 0; }
  doc["last_change"] = unkLastChange.length() ? unkLastChange : String("None since the monitor restarted");
  if (unkLastEp) doc["last_change_time"] = isoUtc(unkLastEp); else doc["last_change_time"] = nullptr;
  String payload;
  serializeJson(doc, payload);
  String topic = String(mqtt_topic) + "/unknown";
  mqttClient.publish(topic.c_str(), payload.c_str(), true);
  unkDirty = false;
}

// Sends one change record to <prefix>/change (retained)
void publishChange(const ChangeRec& c, uint32_t seq) {
  JsonDocument doc;
  doc["text"]    = c.txt;
  if (c.ep) doc["time"] = isoUtc(c.ep); else doc["time"] = nullptr;
  doc["seq"]     = seq;
  String payload;
  serializeJson(doc, payload);
  String topic = String(mqtt_topic) + "/change";
  mqttClient.publish(topic.c_str(), payload.c_str(), true);
}

// --------------------------------------------------------------------------------
// MQTT: HOME ASSISTANT AUTO-DISCOVERY
// --------------------------------------------------------------------------------
void discEntity(const char* comp, const char* key, const char* name, const char* tpl,
                const char* devClass, const char* icon, bool diagnostic, bool measurement,
                const char* unit, const char* topicSuffix = "/state", bool attrs = false) {
  String chipId = getChipIdHex();
  JsonDocument doc;
  doc["name"]               = name;
  doc["state_topic"]        = String(mqtt_topic) + topicSuffix;
  if (attrs) doc["json_attributes_topic"] = String(mqtt_topic) + topicSuffix;
  // Fridge entities need BOTH the board online AND fresh fridge data.
  // Board diagnostics (IP, uptime) only need the board online.
  bool boardOnly = (strcmp(key, "ip") == 0 || strcmp(key, "uptime") == 0);
  JsonArray av = doc["availability"].to<JsonArray>();
  av.add<JsonObject>()["topic"] = String(mqtt_topic) + "/availability";
  if (!boardOnly) {
    av.add<JsonObject>()["topic"] = String(mqtt_topic) + "/data_status";
    doc["availability_mode"] = "all";
  }
  doc["unique_id"]          = "fridge_" + chipId + "_" + key;
  doc["value_template"]     = tpl;
  if (devClass)    doc["device_class"]    = devClass;
  if (icon)        doc["icon"]            = icon;
  if (diagnostic)  doc["entity_category"] = "diagnostic";
  if (measurement) doc["state_class"]     = strstr(key, "_total") ? "total_increasing" : "measurement";
  if (unit) {
    doc["unit_of_measurement"] = unit;
    // whole degrees, except the calibrated sensor temperatures (one decimal place)
    doc["suggested_display_precision"] = (strstr(key, "_air_") || strstr(key, "_est_")) ? 1 : 0;
  }

  JsonObject dev = doc["device"].to<JsonObject>();
  dev["identifiers"][0] = "esp32_fridge_" + chipId;
  dev["name"]           = "Fridge Serial Monitor";
  dev["model"]          = "ESP32 Serial Sniffer";
  dev["manufacturer"]   = "Custom DIY";
  dev["sw_version"]     = FW_VERSION;

  String discTopic = String("homeassistant/") + comp + "/fridge_" + chipId + "_" + key + "/config";
  String payload;
  serializeJson(doc, payload);
  mqttClient.publish(discTopic.c_str(), payload.c_str(), true);
}

// Removes an entity left over from the earlier test versions (empty retained message)
void discRemove(const char* comp, const char* key) {
  String discTopic = String("homeassistant/") + comp + "/fridge_" + getChipIdHex() + "_" + key + "/config";
  mqttClient.publish(discTopic.c_str(), "", true);
}

void publishHomeAssistantDiscovery() {
  discEntity("sensor", "fridge_temp", "Fridge Temperature",
             "{{ value_json.fridge_temp }}", "temperature", nullptr, false, true, "°C");
  discEntity("sensor", "freezer_temp", "Freezer Temperature",
             "{{ value_json.freezer_temp }}", "temperature", nullptr, false, true, "°C");
  discEntity("sensor", "fridge_air_temp", "Fridge Air Temperature",
             "{{ value_json.fridge_air_temp }}", "temperature", nullptr, false, true, "°C");
  discEntity("sensor", "freezer_est_temp", "Freezer Temperature (estimate)",
             "{{ value_json.freezer_est_temp }}", "temperature", nullptr, false, true, "°C");
  discEntity("binary_sensor", "fridge_door",  "Fridge Door",
             "{{ 'ON' if value_json.fridge_door else 'OFF' }}", "door", nullptr, false, false, nullptr);
  discEntity("binary_sensor", "freezer_door", "Freezer Door",
             "{{ 'ON' if value_json.freezer_door else 'OFF' }}", "door", nullptr, false, false, nullptr);
  discEntity("binary_sensor", "settings_mode", "Fridge Settings Mode",
             "{{ 'ON' if value_json.settings_mode else 'OFF' }}", nullptr, "mdi:cog", true, false, nullptr);
  discEntity("sensor", "fridge_setting", "Fridge Set Temperature",
             "{{ value_json.fridge_set_temp }}", "temperature", "mdi:thermometer-lines", false, false, "°C");
  discEntity("sensor", "freezer_set_temp", "Freezer Set Temperature",
             "{{ value_json.freezer_set_temp }}", "temperature", "mdi:thermometer-lines", false, false, "°C");
  discEntity("binary_sensor", "compressor", "Fridge Compressor",
             "{{ 'ON' if value_json.compressor else 'OFF' }}", "running", nullptr, false, false, nullptr);
  discEntity("binary_sensor", "fridge_fan", "Fridge Fan",
             "{{ 'ON' if value_json.fridge_fan else 'OFF' }}", "running", "mdi:fan", false, false, nullptr);
  discEntity("binary_sensor", "freezer_fan", "Freezer Fan",
             "{{ 'ON' if value_json.freezer_fan else 'OFF' }}", "running", "mdi:fan", false, false, nullptr);
  // (unique id key kept as "ice_type" so the existing Home Assistant entity is reused)
  discEntity("sensor", "ice_type", "Fridge Dispenser Selection",
             "{{ value_json.dispenser_selection }}", nullptr, "mdi:cup-water", false, false, nullptr);
  discEntity("binary_sensor", "power_freeze", "Fridge Power Freeze",
             "{{ 'ON' if value_json.power_freeze else 'OFF' }}", nullptr, "mdi:snowflake-alert", false, false, nullptr);
  discEntity("binary_sensor", "ice_off", "Fridge Ice Off",
             "{{ 'ON' if value_json.ice_off else 'OFF' }}", nullptr, "mdi:cube-off-outline", false, false, nullptr);
  discEntity("binary_sensor", "lighting", "Fridge Lighting",
             "{{ 'ON' if value_json.lighting else 'OFF' }}", nullptr, "mdi:lightbulb", false, false, nullptr);
  discEntity("binary_sensor", "vacation", "Fridge Vacation Mode",
             "{{ 'ON' if value_json.vacation else 'OFF' }}", nullptr, "mdi:airplane", false, false, nullptr);
  discEntity("binary_sensor", "child_lock", "Fridge Child Lock",
             "{{ 'ON' if value_json.child_lock else 'OFF' }}", nullptr, "mdi:lock", false, false, nullptr);
  discEntity("sensor", "last_change", "Fridge Last Change",
             "{{ value_json.text[:255] }}", nullptr, "mdi:history", false, false, nullptr, "/change", true);
  discEntity("sensor", "dispensing", "Fridge Dispensing",
             "{{ value_json.dispensing }}", nullptr, "mdi:cup", false, false, nullptr);
  // (unique id key kept as "dispenser_active" so the existing Home Assistant entity is reused)
  discEntity("binary_sensor", "dispenser_active", "Fridge Ice Dispensing",
             "{{ 'ON' if value_json.dispenser_active else 'OFF' }}", "running", "mdi:cube-outline", false, false, nullptr);
  discEntity("sensor", "ice_bucket", "Fridge Ice Bucket (Stabilised)",
             "{{ value_json.ice_bucket }}", nullptr, "mdi:cup", false, false, nullptr);
  // Raw ice bucket flag (unique id key kept as "b18bit4" so the original entity and its history are kept)
  discEntity("binary_sensor", "b18bit4", "Fridge Ice Bucket Full",
             "{{ 'ON' if value_json.ice_bucket_full else 'OFF' }}", nullptr, "mdi:cup", false, false, nullptr);
  discEntity("binary_sensor", "defrost", "Fridge Defrost",
             "{{ 'ON' if value_json.defrost else 'OFF' }}", "heat", "mdi:snowflake-melt", false, false, nullptr);
  discEntity("binary_sensor", "cooling_hold", "Fridge Cooling Hold",
             "{{ 'ON' if value_json.cooling_hold else 'OFF' }}", nullptr, "mdi:pause-circle-outline", false, false, nullptr);
  discEntity("sensor", "ice_cubes_24h", "Fridge Ice Cubes (24 h)",
             "{{ value_json.ice_cubes_24h }}", nullptr, "mdi:cube-outline", false, true, "cubes");
  discEntity("sensor", "ice_cubes_total", "Fridge Ice Cubes Total",
             "{{ value_json.ice_cubes_total }}", nullptr, "mdi:cube-outline", false, true, "cubes");
  discEntity("sensor", "ice_fills_24h", "Fridge Ice Batches (24 h)",
             "{{ value_json.ice_fills_24h }}", nullptr, "mdi:cube-outline", false, true, nullptr);
  discEntity("sensor", "last_ice_fill", "Fridge Last Ice Fill",
             "{{ value_json.last_ice_fill if value_json.last_ice_fill else 'unknown' }}", "timestamp", "mdi:water", false, false, nullptr);
  discEntity("sensor", "cooling_mode", "Fridge Cooling Mode",
             "{{ value_json.cooling_mode }}", nullptr, "mdi:snowflake-thermometer", false, false, nullptr);
  discEntity("sensor", "uptime", "Fridge Monitor Uptime",
             "{{ (value_json.uptime_s / 3600) | round(1) }}", "duration", "mdi:timer-outline", true, true, "h");
  // Bytes and bits not decoded yet (diagnostic entities, from <prefix>/unknown)
  for (uint8_t i : UNK_BYTES) {
    char key[16], name[40], tpl[40];
    snprintf(key, sizeof key, "unk_b%u", i);
    snprintf(name, sizeof name, "Fridge Unknown Byte %u", i);
    snprintf(tpl, sizeof tpl, "{{ value_json.b%u }}", i);
    discEntity("sensor", key, name, tpl, nullptr, "mdi:help-circle-outline", true, false, nullptr, "/unknown");
  }
  discEntity("sensor", "unk_b20_28", "Fridge Unknown Bytes 20-28",
             "{{ value_json.b20_28 }}", nullptr, "mdi:help-circle-outline", true, false, nullptr, "/unknown");
  for (const UnkBit& u : UNK_BITS) {
    char key[20], name[48], tpl[64];
    snprintf(key, sizeof key, "unk_b%u_%02x", u.i, u.mask);
    snprintf(name, sizeof name, "Fridge Unknown Byte %u Bit 0x%02X", u.i, u.mask);
    snprintf(tpl, sizeof tpl, "{{ 'ON' if value_json.b%u_%02x else 'OFF' }}", u.i, u.mask);
    discEntity("binary_sensor", key, name, tpl, nullptr, "mdi:help-circle-outline", true, false, nullptr, "/unknown");
  }
  discEntity("sensor", "unk_last", "Fridge Unknown Last Change",
             "{{ value_json.last_change[:255] }}", nullptr, "mdi:help-circle-outline", true, false, nullptr, "/unknown", true);
  discEntity("sensor", "ip", "Fridge Monitor IP Address",
             "{{ value_json.ip }}", nullptr, "mdi:ip-network", true, false, nullptr);

  // "Fridge Data Receiving": ON while fridge messages are arriving
  {
    String chipId = getChipIdHex();
    JsonDocument doc;
    doc["name"]               = "Fridge Data Receiving";
    doc["state_topic"]        = String(mqtt_topic) + "/data_status";
    doc["payload_on"]         = "online";
    doc["payload_off"]        = "offline";
    doc["availability_topic"] = String(mqtt_topic) + "/availability";
    doc["unique_id"]          = "fridge_" + chipId + "_data_ok";
    doc["device_class"]       = "connectivity";
    doc["entity_category"]    = "diagnostic";
    JsonObject dev = doc["device"].to<JsonObject>();
    dev["identifiers"][0] = "esp32_fridge_" + chipId;
    dev["name"]           = "Fridge Serial Monitor";
    dev["model"]          = "ESP32 Serial Sniffer";
    dev["manufacturer"]   = "Custom DIY";
    String discTopic = "homeassistant/binary_sensor/fridge_" + chipId + "_data_ok/config";
    String payload;
    serializeJson(doc, payload);
    mqttClient.publish(discTopic.c_str(), payload.c_str(), true);
  }

  // Entities from the earlier test versions are removed from Home Assistant
  static const char* const OLD_SENSORS[] = {"sensor_a", "sensor_b", "byte_16", "byte_17", "byte_8", "telemetry",
    "poll_bursts", "run_start", "last_message", "current_run", "outage", "last_run", "last_outage", "run_count"};
  static const char* const OLD_BINARY[] = {"b17bit7", "flashing", "last_change_unknown", "run_active"};
  for (const char* k : OLD_SENSORS) discRemove("sensor", k);
  for (const char* k : OLD_BINARY) discRemove("binary_sensor", k);
  String runs = String(mqtt_topic) + "/runs";
  mqttClient.publish(runs.c_str(), "", true);   // clear the old retained run history
}

// --------------------------------------------------------------------------------
// MQTT: CONNECT / RECONNECT (LWT SETUP)
// --------------------------------------------------------------------------------
void reconnectMQTT() {
  if (strlen(mqtt_server) == 0) return;

  String clientId   = "ESP32Fridge-" + getChipIdHex();
  String availTopic = String(mqtt_topic) + "/availability";

  mqttClient.setBufferSize(2048);   // discovery payloads exceed the 256 byte default

  bool ok;
  if (strlen(mqtt_user) > 0) {
    ok = mqttClient.connect(clientId.c_str(), mqtt_user, mqtt_pass, availTopic.c_str(), 1, true, "offline");
  } else {
    ok = mqttClient.connect(clientId.c_str(), nullptr, nullptr, availTopic.c_str(), 1, true, "offline");
  }

  if (ok) {
    Serial.println(F("MQTT connected."));
    publishHomeAssistantDiscovery();
    // The fridge only talks when something changes, so send what we already
    // know straight away, then mark the device online.
    publishState();
    mqttDirty = false;
    publishUnknown();
    publishDataStatus();
    mqttClient.publish(availTopic.c_str(), "online", true);
  } else {
    Serial.printf("MQTT connect failed, state %d\n", mqttClient.state());
  }
}

// --------------------------------------------------------------------------------
// WEB PAGE
// --------------------------------------------------------------------------------
// PAGE_GZ_BEGIN
// Web page, gzip-compressed (8479 bytes, 23878 uncompressed). Generated from the
// WEB PAGE SOURCE comment at the end of this file.
const uint8_t PAGE_GZ[] PROGMEM = {
  0x1F, 0x8B, 0x08, 0x00, 0x00, 0x00, 0x00, 0x00, 0x02, 0xFF, 0xBD, 0x5C, 0xFB, 0x7A, 0xDB, 0xC6, 0x72, 0xFF, 0xDF, 0x4F,
  0x01, 0x2B, 0x3D, 0x02, 0x10, 0x91, 0x10, 0x49, 0x5D, 0xAC, 0x90, 0x02, 0x55, 0x5B, 0xB6, 0x12, 0xB7, 0x8E, 0xED, 0x46,
  0xF2, 0x49, 0x1B, 0x45, 0x5F, 0x3F, 0x10, 0x58, 0x08, 0x38, 0x02, 0x01, 0x1A, 0x00, 0x45, 0x49, 0xB4, 0xDF, 0xA9, 0xCF,
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  0x47, 0xD0, 0x2F, 0xBF, 0xC6, 0xC0, 0xDF, 0x4B, 0x7F, 0xF6, 0x3F, 0x95, 0x14, 0x59, 0x23, 0x46, 0x5D, 0x00, 0x00
};
const size_t PAGE_GZ_LEN = sizeof(PAGE_GZ);
// PAGE_GZ_END

// --------------------------------------------------------------------------------
// WEB HANDLERS
// --------------------------------------------------------------------------------
void handleRoot() {
  server.sendHeader("Cache-Control", "no-store");   // always serve the page from this firmware
  server.sendHeader("Content-Encoding", "gzip");       // the page is stored gzip-compressed
  server.send_P(200, "text/html; charset=utf-8", (PGM_P)PAGE_GZ, PAGE_GZ_LEN);
}

void handleData() {
  static const char HEXCH[] = "0123456789ABCDEF";
  bool wantFrames = server.hasArg("since");          // only the Diagnostics page asks for frames
  uint32_t since = wantFrames ? strtoul(server.arg("since").c_str(), nullptr, 10) : 0;
  uint32_t start = since + 1;
  if (start < firstSeq) start = firstSeq;
  if (nextSeq > LOG_FRAMES && start < nextSeq - LOG_FRAMES) start = nextSeq - LOG_FRAMES;

  String out;
  out.reserve(1536 + (wantFrames && nextSeq > start ? (nextSeq - start) * (FRAME_MAX * 2 + 40) : 0));
  out += "{\"epoch\":" + String(epoch);
  out += ",\"ver\":\"" FW_VERSION "\"";
  out += ",\"baud\":" + String(cfgBaud);
  out += ",\"fmt\":" + String(cfgFmt);
  out += ",\"inv\":" + String(cfgInvert ? 1 : 0);
  out += ",\"gap\":" + String(cfgGapMs);
  out += ",\"pin\":" + String(RX_PIN);
  out += ",\"bytes\":" + String(totalBytes);
  out += ",\"fe\":" + String((uint32_t)errFrame);
  out += ",\"pe\":" + String((uint32_t)errParity);
  out += ",\"ovf\":" + String((uint32_t)errOverflow);
  out += ",\"rst\":" + String(uartRestarts);
  out += ",\"ln\":{\"e\":" + (anyEdge ? String(millis() - lastLineEdgeMs) : String(-1));
  out += ",\"b\":" + (anyByte ? String(millis() - lastByteMs) : String(-1));
  out += ",\"lv\":" + String(lineLevel);
  out += ",\"fix\":" + String(portFixes) + "}";
  out += ",\"rr\":\"" + String(resetReasonText()) + "\"";
  out += ",\"rssi\":" + String(WiFi.RSSI());
  out += ",\"ssid\":\"" + jsonEsc(WiFi.SSID().c_str()) + "\"";
  out += ",\"ip\":\"" + WiFi.localIP().toString() + "\"";
  out += ",\"up\":" + String(uptimeSec());
  out += ",\"ka\":{\"en\":" + String(cfgKaEn ? 1 : 0) + ",\"sec\":" + String(cfgKaSec) +
         ",\"n\":" + String(kaSent) +
         ",\"ago\":" + (kaLastSent ? String(millis() - kaLastSent) : String(-1)) +
         ",\"ans\":" + (lastAnswerMs ? String(millis() - lastAnswerMs) : String(-1)) + "}";
  out += ",\"cal\":{\"of\":" + String(offFridge, 1) + ",\"oz\":" + String(offFreezer, 1) + "}";
  out += ",\"dec\":{\"m\":\"" + msgHex() + "\"";
  out += ",\"air\":" + (isnan(airTemp) ? String("null") : String(airTemp, 1));
  out += ",\"fz\":" + (isnan(frzTemp) ? String("null") : String(frzTemp, 1));
  out += ",\"ft\":" + (haveFridgeTemp ? String(fridgeTemp) : String("null"));
  out += ",\"zt\":" + (haveFreezerTemp ? String(freezerTemp) : String("null"));
  out += ",\"age\":" + String(haveMsg ? (millis() - lastMsgMs) : 0);
  out += ",\"bad\":" + String(badCount);
  out += ",\"st\":" + String(dataIsStale() ? 1 : 0) + "}";
  out += ",\"ice\":{\"n24\":" + String(iceFills24h()) + ",\"tot\":" + String(iceFillTotal) +
         ",\"ago\":" + (iceFillLastMs ? String(millis() - iceFillLastMs) :
                       (iceFillLastEp && clockValid() ? String((epochNow() - iceFillLastEp) * 1000UL) : String(-1))) +
         ",\"ep\":" + String(iceFillLastEp) + ",\"full\":" + String(iceFull ? 1 : 0) + ",\"fs\":" + String(cfgIceFullSec) + "}";
  out += ",\"chg\":{\"n\":" + String(chgSeq) + ",\"l\":[";
  {
    uint32_t cnt = chgSeq < CHG_N ? chgSeq : CHG_N;
    for (uint32_t k = 0; k < cnt; k++) {           // newest first
      const ChangeRec& c = chgLog[(chgSeq - 1 - k) % CHG_N];
      if (k) out += ',';
      out += "[" + String(millis() - c.ms) + "," + String(c.ep) + ",\"" + jsonEsc(c.txt) + "\"]";
    }
  }
  out += "]}";
  out += ",\"mq\":{\"on\":" + String(mqttClient.connected() ? 1 : 0);
  out += ",\"host\":\"" + jsonEsc(mqtt_server) + "\"";
  out += ",\"port\":" + String(mqtt_port);
  out += ",\"user\":\"" + jsonEsc(mqtt_user) + "\"";
  out += ",\"topic\":\"" + jsonEsc(mqtt_topic) + "\"";
  out += ",\"stale\":" + String(cfgStaleMin) + "}";
  if (wantFrames) {                                  // Diagnostics page: undecoded bytes and bits
    out += ",\"unk\":{\"i\":[";
    for (uint8_t k = 0; k < UNK_N; k++) {
      String label, val;
      if (k < UNK_NBYTES) {
        label = "Byte " + String(UNK_BYTES[k]);
        val = haveMsg ? hx2(lastMsg[UNK_BYTES[k]]) : String("-");
      } else if (k == UNK_NBYTES) {
        label = "Bytes " + String(UNK_FIRST) + "-" + String(UNK_LAST);
        if (haveMsg) for (uint8_t i = UNK_FIRST; i <= UNK_LAST; i++) {
          char h[4]; snprintf(h, sizeof h, i > UNK_FIRST ? " %02X" : "%02X", lastMsg[i]); val += h;
        } else val = "-";
      } else {
        const UnkBit& u = UNK_BITS[k - UNK_NBYTES - 1];
        label = "Byte " + String(u.i) + " bit " + hx2(u.mask);
        val = haveMsg ? String((lastMsg[u.i] & u.mask) ? "On" : "Off") : String("-");
      }
      if (k) out += ',';
      out += "[\"" + label + "\",\"" + val + "\"," + String(unkChgEp[k]) + "," +
             (unkChgMs[k] ? String(millis() - unkChgMs[k]) : String(-1)) + "]";
    }
    out += "],\"l\":[";
    uint32_t cnt = unkLogSeq < UNK_LOG_N ? unkLogSeq : UNK_LOG_N;
    for (uint32_t k = 0; k < cnt; k++) {           // newest first
      const ChangeRec& c = unkLog[(unkLogSeq - 1 - k) % UNK_LOG_N];
      if (k) out += ',';
      out += "[" + String(millis() - c.ms) + "," + String(c.ep) + ",\"" + jsonEsc(c.txt) + "\"]";
    }
    out += "]}";
  }
  out += ",\"last\":" + String(nextSeq - 1);
  out += ",\"frames\":[";
  if (wantFrames) {
    bool first = true;
    for (uint32_t s = start; s < nextSeq; s++) {
      Frame& f = logBuf[s % LOG_FRAMES];
      if (!first) out += ',';
      first = false;
      out += "{\"s\":" + String(s) + ",\"t\":" + String(f.ms) + ",\"h\":\"";
      for (uint16_t i = 0; i < f.len; i++) {
        out += HEXCH[f.data[i] >> 4];
        out += HEXCH[f.data[i] & 0x0F];
      }
      out += "\"}";
    }
  }
  out += "]}";
  server.sendHeader("Cache-Control", "no-store");
  server.send(200, "application/json; charset=utf-8", out);
}

void handleSet() {
  if (server.hasArg("baud")) {
    long b = server.arg("baud").toInt();
    if (b >= 50 && b <= 1000000) cfgBaud = (uint32_t)b;
  }
  if (server.hasArg("fmt")) {
    int f = server.arg("fmt").toInt();
    if (f >= 0 && f < FORMAT_COUNT) cfgFmt = (uint8_t)f;
  }
  if (server.hasArg("inv")) cfgInvert = (server.arg("inv").toInt() != 0);
  if (server.hasArg("gap")) {
    long g = server.arg("gap").toInt();
    if (g >= 2 && g <= 10000) cfgGapMs = (uint32_t)g;
  }
  saveSettings();
  restartCapture();
  server.send(200, "text/plain", "OK");
}

// Called from loop(): samples bytes 12/13 once a second and averages the last 60 s.
// The newest of the status frame (type 07) and the fridge's answer (type 02) is used.
void tempTick() {
  static uint32_t lastMs = 0;
  if (millis() - lastMs < 1000) return;
  lastMs = millis();
  iceClockFix();
  if (!haveMsg || dataIsStale()) { tSampN = 0; airTemp = NAN; frzTemp = NAN; return; }
  bool useLive = liveMs && (int32_t)(liveMs - last07Ms) > 0;
  tSamp12[tSampPos] = useLive ? live12 : lastMsg[12];
  tSamp13[tSampPos] = useLive ? live13 : lastMsg[13];
  tSampPos = (tSampPos + 1) % TAVG_N;
  if (tSampN < TAVG_N) tSampN++;
  uint32_t s12 = 0, s13 = 0;
  for (uint8_t i = 0; i < tSampN; i++) { s12 += tSamp12[i]; s13 += tSamp13[i]; }
  float a12 = (float)s12 / tSampN, a13 = (float)s13 / tSampN;
  airTemp = calA - calS * a13 + offFridge;
  frzTemp = frzFromRaw(a12);                  // includes the freezer adjustment
  // Publish when either has moved by 0.1 C or more
  if (isnan(lastPubAir) || isnan(lastPubFrz) || fabsf(airTemp - lastPubAir) >= 0.1f ||
      fabsf(frzTemp - lastPubFrz) >= 0.1f) mqttDirty = true;
}

void handleIceCfg() {
  long s = server.arg("sec").toInt();
  if (s < 0 || s > 1800) { server.send(400, "text/plain", "0 to 30 minutes"); return; }
  cfgIceFullSec = (uint16_t)s;
  prefs.begin("icecfg", false); prefs.putUShort("fullsec", cfgIceFullSec); prefs.end();
  server.send(200, "text/plain", "OK");
}

void handleCal() {
  float f = server.arg("of").toFloat(), z = server.arg("oz").toFloat();
  if (f < -5.0f || f > 5.0f || z < -5.0f || z > 5.0f) {
    server.send(400, "text/plain", "Values out of range"); return;
  }
  offFridge = f; offFreezer = z;
  prefs.begin("cal", false);
  prefs.putFloat("o", offFridge); prefs.putFloat("f", offFreezer);
  prefs.end();
  tSampN = 0;                               // restart the average with the new adjustment
  mqttDirty = true;
  server.send(200, "text/plain", "OK");
}

void handleSaveMqtt() {
  if (server.hasArg("host"))  strlcpy(mqtt_server, server.arg("host").c_str(), sizeof(mqtt_server));
  if (server.hasArg("port")) {
    int p = server.arg("port").toInt();
    mqtt_port = (p > 0 && p <= 65535) ? p : 1883;
  }
  if (server.hasArg("user"))  strlcpy(mqtt_user, server.arg("user").c_str(), sizeof(mqtt_user));
  // Blank password = keep the saved one (unless the user name was cleared too)
  if (server.arg("pass").length() > 0) strlcpy(mqtt_pass, server.arg("pass").c_str(), sizeof(mqtt_pass));
  else if (strlen(mqtt_user) == 0)     mqtt_pass[0] = '\0';
  if (server.hasArg("stale")) {
    long m = server.arg("stale").toInt();
    if (m >= 0 && m <= 1440) cfgStaleMin = (uint16_t)m;
  }
  lastPubStale = -1;                       // re-send data_status after reconnect
  if (server.hasArg("topic") && server.arg("topic").length() > 0) {
    strlcpy(mqtt_topic, server.arg("topic").c_str(), sizeof(mqtt_topic));
  }
  saveSettings();

  if (mqttClient.connected()) mqttClient.disconnect();
  if (strlen(mqtt_server) > 0) mqttClient.setServer(mqtt_server, mqtt_port);
  lastMQTTAttempt = 0;
  server.send(200, "text/plain", "OK");
}

void handleClear() {
  clearLog();
  server.send(200, "text/plain", "OK");
}

// --------------------------------------------------------------------------------
// KEEPALIVE: asks the fridge for its status (type 00) every cfgKaSec seconds
// --------------------------------------------------------------------------------
void kaTick() {
  if (!cfgKaEn) return;
  if (kaLastTickMs && millis() - kaLastTickMs < (uint32_t)cfgKaSec * 1000UL) return;
  kaLastTickMs = millis();
  if (!kaLastTickMs) kaLastTickMs = 1;
  uint8_t buf[MSG_LEN];
  if (haveMsg) memcpy(buf, lastMsg, MSG_LEN);   // the latest status frame
  else { memcpy(buf, KA_DEFAULT, MSG_LEN); buf[4] = lastCounter; }   // none since the restart yet
  buf[4] = lastCounter;                     // the fridge's current counter
  buf[5] = 0x00;                            // message type 00 = "read status"
  uint8_t x = 0; for (int i = 0; i < 29; i++) x ^= buf[i];
  buf[29] = x;
  hwSerial.write(buf, MSG_LEN);
  kaSent++;
  kaLastSent = millis();
  if (!kaLastSent) kaLastSent = 1;
}

void handleKeepalive() {
  cfgKaEn  = server.arg("en") == "1";
  long s = server.arg("sec").toInt();
  if (s >= 2 && s <= 3600) cfgKaSec = (uint16_t)s;
  saveKeepalive();
  kaLastTickMs = 0;                         // send one straight away, then at the new interval
  server.send(200, "text/plain", "OK");
}

// Wi-Fi scan for the setup page. The scan runs in the background:
//   /wifi-scan.json?start=1  starts a new scan
//   /wifi-scan.json          returns {"scanning":1} or the list of networks
void handleWifiScan() {
  int n = WiFi.scanComplete();
  if (server.hasArg("start") && n != WIFI_SCAN_RUNNING) {
    WiFi.scanDelete();
    WiFi.scanNetworks(true);                 // true = asynchronous
    n = WIFI_SCAN_RUNNING;
  }
  server.sendHeader("Cache-Control", "no-store");
  if (n == WIFI_SCAN_RUNNING) { server.send(200, "application/json", "{\"scanning\":1}"); return; }
  String out = "{\"scanning\":0,\"nets\":[";
  bool first = true;
  for (int i = 0; i < n; i++) {
    String ssid = WiFi.SSID(i);
    if (ssid.length() == 0) continue;        // hidden network
    // A mesh shows the same name several times: keep only the strongest one
    bool dup = false;
    for (int j = 0; j < n; j++) {
      if (j != i && WiFi.SSID(j) == ssid &&
          (WiFi.RSSI(j) > WiFi.RSSI(i) || (WiFi.RSSI(j) == WiFi.RSSI(i) && j < i))) { dup = true; break; }
    }
    if (dup) continue;
    if (!first) out += ',';
    first = false;
    out += "{\"s\":\"" + jsonEsc(ssid.c_str()) + "\",\"r\":" + String(WiFi.RSSI(i)) +
           ",\"o\":" + String(WiFi.encryptionType(i) == WIFI_AUTH_OPEN ? 1 : 0) + "}";
  }
  out += "]}";
  server.send(200, "application/json; charset=utf-8", out);
}

void handleSaveWifi() {
  String ssid = server.arg("manual_ssid");
  ssid.trim();
  if (ssid.length() == 0) ssid = server.arg("ssid");
  String pass = server.arg("password");
  if (ssid.length() == 0) { server.send(400, "text/plain", "No network name entered."); return; }
  server.send(200, "text/html; charset=utf-8",
              F("<html><body><h2>Joining new network...</h2><p>The device is saving the new Wi-Fi details and restarting. "
                "If it cannot join, it will come back as the <b>ESP32-Fridge-AP</b> setup network.</p></body></html>"));
  delay(1000);
  WiFi.persistent(true);
  WiFi.begin(ssid.c_str(), pass.c_str());
  delay(1500);
  ESP.restart();
}

void handleResetWifi() {
  server.send(200, "text/html; charset=utf-8",
              F("<html><body><h2>Wi-Fi erased</h2><p>Restarting in AP mode (<b>ESP32-Fridge-AP</b>).</p></body></html>"));
  delay(1000);
  wm.resetSettings();
  delay(500);
  ESP.restart();
}

// --------------------------------------------------------------------------------
// SETUP
// --------------------------------------------------------------------------------
void setup() {
  Serial.begin(115200);
  // Give the PC up to 3 s to open the USB serial port so boot messages are seen
  uint32_t t0 = millis();
  while (!Serial && millis() - t0 < 3000) delay(10);
  Serial.println();
  Serial.println(F("=== Fridge Monitor v" FW_VERSION " booting ==="));

  loadSettings();
  loadKeepalive();
  loadCal();
  loadIce();                                // ice batch total and recent fill times
  prefs.begin("icecfg", true); cfgIceFullSec = prefs.getUShort("fullsec", 240); prefs.end();
  if (cfgIceFullSec > 1800) cfgIceFullSec = 240;
  memset(msgWin, 0xFF, sizeof(msgWin));
  beginFridgeSerial();

  if (strlen(mqtt_server) > 0) mqttClient.setServer(mqtt_server, mqtt_port);
  mqttClient.setSocketTimeout(1);

  server.on("/", HTTP_GET, handleRoot);
  server.on("/diagnostics", HTTP_GET, handleRoot);   // same page file, the script shows the right section
  server.on("/serial", HTTP_GET, handleRoot);
  server.on("/wifi", HTTP_GET, handleRoot);
  server.on("/mqtt", HTTP_GET, handleRoot);          // MQTT is on the Wi-Fi page now
  server.on("/calibration", HTTP_GET, handleRoot);
  server.on("/data.json", HTTP_GET, handleData);
  server.on("/wifi-scan.json", HTTP_GET, handleWifiScan);
  server.on("/save-wifi", HTTP_POST, handleSaveWifi);
  server.on("/resetwifi", HTTP_POST, handleResetWifi);
  server.on("/save-mqtt", HTTP_POST, handleSaveMqtt);
  server.on("/set", HTTP_POST, handleSet);
  server.on("/keepalive", HTTP_POST, handleKeepalive);
  server.on("/cal", HTTP_POST, handleCal);
  server.on("/ice-cfg", HTTP_POST, handleIceCfg);
  server.on("/settings", HTTP_GET, handleRoot);
  server.on("/clear", HTTP_POST, handleClear);
  server.onNotFound([]() { server.send(404, "text/plain", "Not found"); });

  // Non-blocking WiFiManager: loop() keeps running (and keeps printing status)
  // even while the device is waiting in WiFi setup mode.
  Serial.println(F("Connecting to WiFi..."));
  // ESP32-C3 Super Mini fix: many of these boards have a poorly matched antenna
  // and fail to connect at full transmit power. Turning it down fixes that.
  WiFi.mode(WIFI_STA);
  WiFi.setTxPower(WIFI_TX_POWER);

  // Print WHY any connection attempt fails.
  WiFi.onEvent([](WiFiEvent_t event, WiFiEventInfo_t info) {
    int r = info.wifi_sta_disconnected.reason;
    const char* txt = "see ESP32 wifi_err_reason_t list";
    if (r == 201) txt = "NO_AP_FOUND - cannot hear that network at all";
    else if (r == 2 || r == 202) txt = "AUTH failed/expired - router did not answer or rejected us";
    else if (r == 15 || r == 204) txt = "HANDSHAKE_TIMEOUT - usually wrong password or very weak signal";
    else if (r == 200) txt = "BEACON_TIMEOUT - signal too weak / lost";
    else if (r == 203) txt = "ASSOC_FAIL - router refused the association";
    else if (r == 8) txt = "ASSOC_LEAVE - we disconnected ourselves";
    Serial.printf("WiFi DISCONNECT reason %d: %s\n", r, txt);
  }, ARDUINO_EVENT_WIFI_STA_DISCONNECTED);

  // List every network the radio can hear, with signal strength.
  Serial.println(F("Scanning for WiFi networks..."));
  int found = WiFi.scanNetworks();
  if (found <= 0) {
    Serial.println(F("  NO NETWORKS FOUND - the radio/antenna is not receiving anything."));
  } else {
    for (int i = 0; i < found; i++) {
      Serial.printf("  %-28s %4d dBm  ch %d\n", WiFi.SSID(i).c_str(), (int)WiFi.RSSI(i), (int)WiFi.channel(i));
    }
  }
  WiFi.scanDelete();

  wm.setConnectTimeout(45);                 // give up on the saved network after 45 s
  wm.setConfigPortalBlocking(false);
  if (wm.autoConnect("ESP32-Fridge-AP")) startNetServices();
}

// Started once WiFi is connected (the setup portal uses port 80 until then)
void startNetServices() {
  configTzTime("UTC0", "pool.ntp.org", "time.google.com");   // internet time for change timestamps
  WiFi.setTxPower(WIFI_TX_POWER);       // keep the Super Mini fix applied
  ArduinoOTA.setHostname("ESP32-FridgeSniffer");
  ArduinoOTA.begin();                       // also starts mDNS with the hostname above
  MDNS.addService("http", "tcp", 80);       // http://esp32-fridgesniffer.local
  server.begin();
  netStarted = true;
  Serial.println("Connected! Web page: http://" + WiFi.localIP().toString());
}

// --------------------------------------------------------------------------------
// MAIN LOOP
// --------------------------------------------------------------------------------
void loop() {
  tempTick();
  iceBucketTick();
  kaTick();

  if (netStarted) {
    ArduinoOTA.handle();
    server.handleClient();

    // Wi-Fi watchdog
    static uint32_t wifiLostMs = 0, lastKickMs = 0;
    if (WiFi.status() == WL_CONNECTED) {
      wifiLostMs = 0;
    } else {
      uint32_t now = millis();
      if (wifiLostMs == 0) { wifiLostMs = now ? now : 1; lastKickMs = wifiLostMs; }
      if (now - wifiLostMs > 300000UL) {
        Serial.println(F("Wi-Fi lost for 5 minutes - restarting."));
        delay(200);
        ESP.restart();
      }
      if (now - lastKickMs > 30000UL) {
        lastKickMs = now;
        Serial.println(F("Wi-Fi lost - forcing a reconnect."));
        WiFi.reconnect();
      }
    }

    // MQTT: keep connected, publish whenever the fridge state changes
    if (strlen(mqtt_server) > 0) {
      if (!mqttClient.connected()) {
        // Only try while Wi-Fi is up: a connect attempt blocks the loop, and
        // with no network it would block for its full timeout every time.
        if (WiFi.status() == WL_CONNECTED &&
            (lastMQTTAttempt == 0 || millis() - lastMQTTAttempt > 15000)) {
          lastMQTTAttempt = millis();
          if (lastMQTTAttempt == 0) lastMQTTAttempt = 1;
          reconnectMQTT();
        }
      } else {
        mqttClient.loop();
        if ((dataIsStale() ? 1 : 0) != lastPubStale) publishDataStatus();
        // Uptime for Home Assistant: refresh the state every 5 minutes
        if (millis() - lastPubMs >= 300000UL) mqttDirty = true;
        if (mqttDirty) {
          // Door / mode changes go out immediately; everything else is
          // limited to one publish per second.
          bool urgent = haveMsg && (lastMsg[18] != lastPubB18 || lastMsg[16] != lastPubB16 ||
                                    lastMsg[8] != lastPubB8 || lastMsg[17] != lastPubB17);
          if (urgent || millis() - lastPubMs >= 1000) { mqttDirty = false; publishState(); }
        }
        // Undecoded bytes/bits: when they change (and once the first message is in)
        if (unkDirty && haveMsg) publishUnknown();
        // Change log: every change goes out in order (oldest first)
        if (chgSeq - chgPubSeq > CHG_N) chgPubSeq = chgSeq - CHG_N;
        while (chgPubSeq < chgSeq) {
          publishChange(chgLog[chgPubSeq % CHG_N], chgPubSeq + 1);
          chgPubSeq++;
        }
      }
    }
  } else {
    wm.process();                                         // WiFi setup portal
    // The saved network can still join in the background while setup mode is
    // running (slow joins). As soon as that happens, close the setup access
    // point and start the real web page.
    static uint32_t connectedSince = 0;
    if (WiFi.status() == WL_CONNECTED) {
      if (connectedSince == 0) connectedSince = millis();
      if (millis() - connectedSince >= 3000) {            // stable for 3 s
        if (wm.getConfigPortalActive()) {
          Serial.println(F("WiFi joined - closing setup access point."));
          wm.stopConfigPortal();
          WiFi.mode(WIFI_STA);
        }
        startNetServices();
      }
    } else {
      connectedSince = 0;
    }
    // 3 min in setup mode with nobody connected to the setup network:
    // restart and try the saved Wi-Fi again.
    if (!netStarted && millis() > 180000UL && WiFi.softAPgetStationNum() == 0) {
      Serial.println(F("Setup mode timed out - restarting to retry the saved Wi-Fi."));
      delay(200);
      ESP.restart();
    }
  }

  // Print the status on USB serial every 5 seconds so it is easy to find
  static uint32_t lastIpPrint = 0;
  if (millis() - lastIpPrint >= 5000) {
    lastIpPrint = millis();
    if (!netStarted) {
      Serial.println(F("SETUP MODE: not on your WiFi yet. Join the WiFi network 'ESP32-Fridge-AP' "
                       "with a phone or PC and browse to http://192.168.4.1 to enter your WiFi details."));
    } else if (WiFi.status() == WL_CONNECTED) {
      Serial.println("Web page: http://" + WiFi.localIP().toString() +
                     "  or  http://esp32-fridgesniffer.local   (WiFi: " + WiFi.SSID() +
                     ", " + String(WiFi.RSSI()) + " dBm)");
    } else {
      Serial.println(F("WiFi not connected - trying to reconnect..."));
    }
  }

  // The ESP32 serial driver can stop receiving after its buffer overflows
  // (for example if the loop was held up). Restart the port to recover.
  if (uartNeedsRestart) {
    uartNeedsRestart = false;
    uartRestarts++;
    Serial.println(F("Restarting the fridge serial port."));
    hwSerial.end();
    delay(20);
    beginFridgeSerial();
    memset(msgWin, 0xFF, sizeof(msgWin));
    curLen = 0;
  }

  // Signal monitor: watch the pin itself. If the line is toggling but the
  // serial port delivers no bytes, the port is stuck - restart it.
  int lv = gpio_get_level((gpio_num_t)RX_PIN);
  if (lv != lineLevel) { lineLevel = lv; lineEdges++; lastLineEdgeMs = millis(); anyEdge = true; }
  static uint32_t wdMs = 0, wdEdges = 0, wdBytes = 0, lastFixMs = 0;
  static uint8_t strikes = 0;
  if (millis() - wdMs >= 5000) {
    bool stuck = (lineEdges - wdEdges >= 20) && (rxByteCount == wdBytes);
    wdMs = millis(); wdEdges = lineEdges; wdBytes = rxByteCount;
    strikes = stuck ? strikes + 1 : 0;
    if (strikes >= 2 && millis() - lastFixMs > 20000) {
      strikes = 0;
      lastFixMs = millis();
      portFixes++;
      Serial.println(F("Signal present on the pin but no bytes received."));
      uartNeedsRestart = true;
    }
  }

  // 1. Read incoming bytes
  while (hwSerial.available()) {
    uint8_t b = hwSerial.read();
    feedDecoder(b);
    rxByteCount++; lastByteMs = millis(); anyByte = true;
    if (curLen == 0) curStartMs = millis();
    curBuf[curLen++] = b;
    totalBytes++;
    lastRxMs = millis();
    if (curLen >= FRAME_MAX) flushFrame();   // long burst: wrap onto a new line
  }

  // 2. Bus silent for the gap time -> close the frame
  if (curLen > 0 && (millis() - lastRxMs >= cfgGapMs)) flushFrame();
}

// --------------------------------------------------------------------------------
// WEB PAGE SOURCE (readable). The firmware serves the gzip copy in PAGE_GZ above,
// which is generated from this text - edit here, then regenerate PAGE_GZ.
// --------------------------------------------------------------------------------
/*PAGE_SOURCE_BEGIN
<!DOCTYPE html><html><head>
<meta charset='UTF-8'><meta name='viewport' content='width=device-width, initial-scale=1'>
<title>Fridge Monitor</title>
<style>
*{box-sizing:border-box;}
body{font-family:Arial,sans-serif;margin:0;background:#f4f4f4;}
.header-banner{background:#0066cc;color:#fff;padding:15px 20px;text-align:center;box-shadow:0 2px 4px rgba(0,0,0,.1);}
.header-banner h1{margin:0;font-size:24px;}
.container{max-width:1000px;background:#fff;padding:20px;margin:20px auto;border-radius:8px;box-shadow:0 0 10px rgba(0,0,0,.1);}
h2{color:#333;margin:18px 0 8px;font-size:18px;}
.row{display:flex;flex-wrap:wrap;gap:12px;align-items:flex-end;}
.row label{font-size:13px;color:#444;display:flex;flex-direction:column;gap:4px;}
select,input[type=number],input[type=text],input[type=password]{padding:8px;min-width:110px;box-sizing:border-box;}
.cards{display:grid;grid-template-columns:repeat(auto-fill,minmax(150px,1fr));gap:10px;}
.card{background:#f7f9fc;border:1px solid #dde3ea;border-radius:6px;padding:10px;min-width:0;overflow-wrap:anywhere;}
.card span{display:block;font-size:12px;color:#666;margin-bottom:4px;}
.card b{font-size:18px;color:#222;}
.card.open{background:#fff3f3;border-color:#ffb3b3;} .card.open b{color:#dc3545;}
#chgTbl td.tm,#unkLog td.tm{white-space:nowrap;color:#666;} #unkTbl th{text-align:left;padding:3px 10px 3px 0;border-bottom:1px solid #ccc;font-weight:bold;color:#444;} #unkTbl td.v{font-family:monospace;} #unkTbl td.ch{font-weight:bold;color:#b36b00;} #chgTbl td,#unkTbl td,#unkLog td{overflow-wrap:anywhere;padding:3px 10px 3px 0;border-bottom:1px solid #eee;vertical-align:top;}
button{background:#28a745;color:#fff;border:none;padding:9px 14px;border-radius:4px;cursor:pointer;}
button.blue{background:#0066cc;} button.grey{background:#6c757d;} button.red{background:#dc3545;}
.chk{flex-direction:row!important;align-items:center;padding-bottom:9px;}
.stat{font-size:14px;color:#333;margin-top:10px;line-height:1.7;}
.note{font-size:13px;color:#666;}
.bad{color:#dc3545;font-weight:bold;} .msg{background:#eef5ff;border:1px solid #cfe0f7;padding:8px 10px;border-radius:4px;margin-top:10px;font-size:14px;}
.log{background:#1e1e1e;color:#00ff66;font-family:monospace;font-size:13px;border-radius:4px;height:480px;overflow:auto;margin-top:10px;}
.log table{border-collapse:collapse;width:100%;}
.log th{position:sticky;top:0;background:#333;color:#ddd;text-align:left;padding:5px 8px;}
.log td{padding:2px 8px;white-space:pre;vertical-align:top;}
.log td.t,.log td.d,.log td.n{color:#8a8;} .log td.a{color:#ffd866;}
.log b{color:#ff5555;}
nav{display:flex;flex-wrap:wrap;gap:8px 16px;margin-bottom:6px;} nav a{text-decoration:none;color:#0066cc;font-weight:bold;white-space:nowrap;} nav a.cur{color:#333;border-bottom:2px solid #0066cc;}
.pg{display:none;}
@media (max-width:600px){.container{margin:0;border-radius:0;padding:12px;}.header-banner{padding:12px;}.header-banner h1{font-size:20px;}.card b{font-size:16px;}.row label,.row select,.row input{max-width:100%;}#wSel{min-width:0!important;width:100%;}}
.card-danger{background:#fff3f3;border:1px solid #ffcdd2;padding:15px;border-radius:6px;margin-top:20px;}
</style></head><body>
<div class='header-banner'><h1>Fridge Monitor <span id='ver' style='font-size:14px;font-weight:normal'></span></h1></div>
<div class='container'>
<div id='lost' style='display:none;background:#dc3545;color:#fff;padding:10px;border-radius:4px;margin-bottom:10px;font-weight:bold'></div>
<nav><a href='/' id='nMain'>Status</a><a href='/diagnostics' id='nDiag'>Diagnostics</a><a href='/serial' id='nSerial'>Serial Setup</a><a href='/wifi' id='nWifi'>Wi-Fi &amp; MQTT</a><a href='/settings' id='nCal'>Settings</a></nav><hr>

<div class='pg' id='pgMain'>
<h2>Fridge Status</h2>
<div class='cards' style='grid-template-columns:1fr 1fr'>
 <div class='card' id='cFd'><span>Fridge door</span><b id='dFd'>-</b></div>
 <div class='card' id='cFz'><span>Freezer door</span><b id='dFz'>-</b></div>
 <div class='card'><span>Fridge display temperature</span><b id='dFt'>-</b></div>
 <div class='card'><span>Freezer display temperature</span><b id='dZt'>-</b></div>
 <div class='card'><span>Fridge set temperature</span><b id='dSet'>-</b></div>
 <div class='card'><span>Freezer set temperature</span><b id='dZs'>-</b></div>
 <div class='card'><span>Fridge temperature (sensor)</span><b id='dAir'>-</b></div>
 <div class='card'><span>Freezer temperature (sensor, estimate)</span><b id='dFzE'>-</b></div>
</div>
<div class='cards' style='margin-top:10px'>
 <div class='card'><span>Dispenser selection</span><b id='dIce'>-</b></div>
 <div class='card'><span>Ice dispensing</span><b id='dId'>-</b></div>
 <div class='card'><span>Power Freeze</span><b id='dPf'>-</b></div>
 <div class='card'><span>Ice Off</span><b id='dIo'>-</b></div>
 <div class='card'><span>Lighting</span><b id='dLt'>-</b></div>
 <div class='card'><span>Child Lock</span><b id='dCl'>-</b></div>
 <div class='card'><span>Vacation mode</span><b id='dVa'>-</b></div>
 <div class='card'><span>Compressor</span><b id='dCp'>-</b></div>
 <div class='card'><span>Fridge fan</span><b id='dFf'>-</b></div>
 <div class='card'><span>Freezer fan</span><b id='dZf'>-</b></div>
 <div class='card'><span>Ice bucket</span><b id='dBk'>-</b></div>
 <div class='card'><span>Ice made (24 h)</span><b id='dIf'>-</b></div>
 <div class='card'><span>Defrost</span><b id='dDf'>-</b></div>
 <div class='card'><span>Cooling mode</span><b id='dCm'>-</b></div>
 <div class='card'><span>Gateway link</span><b id='dGw'>-</b></div>
 <div class='card'><span>Uptime</span><b id='dUp'>-</b></div>
</div>
<div class='stat' id='dInfo'>Waiting for data...</div>

<h2>Recent Changes</h2>
<div class='card' id='cChg' style='margin-bottom:8px'><span>Last change</span><b id='dChg' style='font-size:16px'>-</b></div>
<table style='font-size:13px;border-collapse:collapse;width:100%' id='chgTbl'></table>
</div>

<div class='pg' id='pgDiag'>
<h2>Link</h2>
<div class='stat' id='stat'>Connecting...</div>
<div class='stat' id='lineStat'></div>
<div class='stat' id='kStatD'></div>

<h2>Undecoded Bytes</h2>
<p class='note'>Bytes and bits whose meaning isn't known yet. Most have never changed. When one does, note what the fridge was doing at that time.</p>
<table style='font-size:13px;border-collapse:collapse;width:100%' id='unkTbl'></table>
<h3 style='font-size:15px;color:#333;margin:14px 0 6px'>Undecoded changes</h3>
<table style='font-size:13px;border-collapse:collapse;width:100%' id='unkLog'></table>

<h2>Captured Data</h2>
<div class='row'>
 <button class='grey' id='pauseBtn' onclick='togglePause()'>Pause</button>
 <button class='red' onclick='clearLog()'>Clear</button>
 <button class='grey' onclick='download()'>Download .txt</button>
 <label class='chk'><input type='checkbox' id='auto' checked>&nbsp;Auto-scroll</label>
 <label class='chk'><input type='checkbox' id='hl' checked>&nbsp;Highlight changed bytes</label>
</div>
<div class='log' id='log'><table><thead><tr><th>Time (s)</th><th>Gap (ms)</th><th>Len</th><th>Hex</th><th>ASCII</th></tr></thead><tbody id='rows'></tbody></table></div>
<p class='note'>Red bytes differ from the previous frame of the same length.</p>
</div>

<div class='pg' id='pgSerial'>
<h2>Serial Settings</h2>
<div class='row'>
 <label>Baud rate<select id='baud'></select></label>
 <label>Custom baud<input type='number' id='cbaud' placeholder='optional'></label>
 <label>Format<select id='fmt'></select></label>
 <label>Frame gap (ms)<input type='number' id='gap' min='2' max='10000'></label>
 <label class='chk'><input type='checkbox' id='inv'>&nbsp;Invert</label>
 <button onclick='applySet()'>Apply</button>
</div>
<h2>Keepalive</h2>
<div class='row'>
 <label class='chk'><input type='checkbox' id='kEn'>&nbsp;Enabled</label>
 <label>Send every (seconds)<input type='number' id='kSec' min='2' max='3600'></label>
 <button class='blue' onclick='saveKa()'>Save</button>
</div>
<div class='stat' id='kStat'></div>
<p class='note'>The ESP asks the fridge for its status (a type 00 read) at this interval. This is what keeps the fridge sending data. 90 seconds works well.</p>
</div>

<div class='pg' id='pgWifi'>
<h2>Wi-Fi</h2>
<div class='stat' id='wInfo'>Connecting...</div>
<h2>Join a different network</h2>
<form action='/save-wifi' method='POST'>
<div class='row'>
 <label>Network<select name='ssid' id='wSel' style='min-width:260px'><option value=''>Scanning...</option></select></label>
 <button type='button' class='grey' onclick='wifiScan()'>Scan again</button>
</div>
<div class='row' style='margin-top:10px'>
 <label>Or type a network name (hidden networks)<input type='text' name='manual_ssid' placeholder='optional'></label>
 <label>Password<input type='password' name='password'></label>
 <button type='submit'>Join Network</button>
</div>
</form>
<p class='note'>The device saves the new details and restarts. 2.4 GHz networks only.</p>

<h2>MQTT / Home Assistant</h2>
<div class='row'>
 <label>Broker IP / host<input type='text' id='mh'></label>
 <label>Port<input type='number' id='mp'></label>
 <label>User<input type='text' id='mu'></label>
 <label>Password<input type='password' id='mw' placeholder='(unchanged)'></label>
 <label>Topic prefix<input type='text' id='mt'></label>
 <label>No-data timeout (min, 0 = off)<input type='number' id='ms' min='0' max='1440'></label>
 <button onclick='saveMqtt()'>Save &amp; Reconnect</button>
</div>
<p class='note'>Leave the password blank to keep the saved one. Clear the broker field to turn MQTT off.</p>
<div class='stat' id='mStat'></div>

<div class='card-danger'>
<h3 style='color:#dc3545;margin-top:0;'>Forget Wi-Fi Credentials</h3>
<p>Erases the saved Wi-Fi details and restarts in setup mode. Join the <b>ESP32-Fridge-AP</b> network and browse to 192.168.4.1 to set it up again.</p>
<form action='/resetwifi' method='POST' onsubmit='return confirm("Forget Wi-Fi and restart in AP mode?");'><button class='red'>Forget Wi-Fi &amp; Restart AP</button></form>
</div>
</div>

<div class='pg' id='pgCal'>
<h2>Temperature Calibration</h2>
<p class='note'>Adds or subtracts a few degrees from the temperature measured by the sensor, for the Status page and Home Assistant. Compare with a thermometer in the fridge and freezer and enter the difference.</p>
<div class='cards' style='grid-template-columns:1fr 1fr'>
 <div class='card'><span>Fridge temperature (sensor) now</span><b id='cAir'>-</b></div>
 <div class='card'><span>Freezer temperature (sensor) now</span><b id='cFzv'>-</b></div>
</div>
<div class='row' style='margin-top:14px'>
 <label>Fridge adjustment (&deg;C)<input type='number' id='oF' step='0.1' min='-5' max='5'></label>
 <button class='grey' onclick='nudge("oF",-0.5)'>&minus; 0.5</button>
 <button class='grey' onclick='nudge("oF",0.5)'>+ 0.5</button>
 <label>Freezer adjustment (&deg;C)<input type='number' id='oZ' step='0.1' min='-5' max='5'></label>
 <button class='grey' onclick='nudge("oZ",-0.5)'>&minus; 0.5</button>
 <button class='grey' onclick='nudge("oZ",0.5)'>+ 0.5</button>
 <button onclick='saveCal()'>Save</button>
</div>
<p class='note'>Allowed range: &minus;5 to +5 &deg;C. The temperatures are averaged over the last 60 seconds, so a change takes about a minute to settle.</p>
<h2>Ice Bucket</h2>
<div class='row'>
 <label>Show &quot;Full&quot; after it has been full for (minutes)<input type='number' id='iFs' step='0.5' min='0' max='30'></label>
 <button onclick='saveIce()'>Save</button>
</div>
<p class='note'>The ice maker checks the ice level now and then, and the fridge reports &quot;full&quot; for up to about 3 minutes during each check. The stabilised ice bucket only shows Full once it has stayed full this long. 0 = show it straight away.</p>
</div>
</div>
<script>
const BAUDS=[300,600,1200,2400,4800,9600,14400,19200,38400,57600,115200];
const FMTS=['8N1','8E1','8O1','7E1','7O1','8N2'];
let curSsid='',scanTimer=null,PG='Main';
let since=0,epoch=-1,paused=false,busy=false,mqInit=false,calInit=false,kaInit=false,iceInit=false,lastOk=Date.now(),prev={},lastT=null,lines=[];
function $(i){return document.getElementById(i);}
function init(){
  BAUDS.forEach(b=>$('baud').add(new Option(b,b)));
  FMTS.forEach((f,i)=>$('fmt').add(new Option(f,i)));
  PG={'/diagnostics':'Diag','/serial':'Serial','/wifi':'Wifi','/mqtt':'Wifi','/calibration':'Cal','/settings':'Cal'}[location.pathname]||'Main';
  $('pg'+PG).style.display='block';$('n'+PG).className='cur';
  if(PG==='Wifi')setTimeout(wifiScan,1500);
  poll();setInterval(poll,PG==='Diag'?700:1500);
  setInterval(()=>{const s=Math.round((Date.now()-lastOk)/1000),l=$('lost');
    if(s>=6){l.style.display='block';l.textContent='No contact with the board for '+s+' s (Wi-Fi dropout or board restarting). The data below is not updating.';}
    else l.style.display='none';},1000);
}
function ago(ms){return ms<0?'never':(ms<1000?'just now':(ms<90000?Math.round(ms/1000)+' s ago':Math.round(ms/60000)+' min ago'));}
function fmtUp(s){const d=Math.floor(s/86400),h=Math.floor(s%86400/3600),m=Math.floor(s%3600/60);return d>0?d+' d '+h+' h':(h>0?h+' h '+m+' min':m+' min');}
function dt(e){return e?new Date(e*1000).toLocaleString():'-';}
function dtShort(e){const d=new Date(e*1000),p=v=>String(v).padStart(2,'0');
  return p(d.getDate())+'/'+p(d.getMonth()+1)+'/'+p(d.getFullYear()%100)+' '+d.toLocaleTimeString([],{hour:'numeric',minute:'2-digit'});}
function esc(t){return t.replace(/[&<>]/g,c=>({'&':'&amp;','<':'&lt;','>':'&gt;'})[c]);}
function deg(v){return (v===null||v===undefined)?'-':v+' °C';}
function deg1(v){return (v===null||v===undefined)?'-':v.toFixed(1)+' °C';}
function showDec(d){
  const q=d.dec;
  const mq=' &nbsp;|&nbsp; MQTT: '+(d.mq.host?(d.mq.on?'Connected':"<span class='bad'>Disconnected</span>"):'not configured');
  $('dUp').textContent=fmtUp(d.up);
  if(!q.m){$('dInfo').innerHTML='No status message received from the fridge yet.'+mq;return;}
  const b=[];for(let i=0;i<q.m.length;i+=2)b.push(parseInt(q.m.substr(i,2),16));
  const fd=!!(b[18]&0x40),fz=!!(b[18]&0x80),fi=b[9]&15,zi=b[9]>>4;
  $('dFd').textContent=fd?'OPEN':'Closed';$('cFd').className='card'+(fd?' open':'');
  $('dFz').textContent=fz?'OPEN':'Closed';$('cFz').className='card'+(fz?' open':'');
  $('dFt').textContent=deg(q.ft);
  $('dZt').textContent=deg(q.zt);
  $('dSet').textContent=fi<=6?(7-fi)+' °C':'-';
  $('dZs').textContent=zi<=11?(-(14+zi))+' °C':'-';
  $('dAir').textContent=deg1(q.air);
  $('dFzE').textContent=deg1(q.fz);
  $('dIce').textContent=({0:'Crushed ice',2:'Water',4:'Cubed ice',6:'Water'})[b[8]&6];
  $('dId').textContent=(b[17]&0x04)?('Dispensing '+(({0:'crushed ice',4:'cubed ice'})[b[8]&6]||'ice')):'No';
  $('dPf').textContent=(b[8]&0x80)?'On':'Off';
  $('dIo').textContent=(b[8]&0x08)?'On (ice maker off)':'Off';
  $('dLt').textContent=(b[8]&0x01)?'On':'Off';
  $('dCl').textContent=(b[8]&0x10)?'On':'Off';
  $('dVa').textContent=(b[8]&0x20)?'On':'Off';
  $('dCp').textContent=(b[16]&0x80)?'Running':'Off';
  $('dFf').textContent=(b[16]&0x10)?'Running':((b[16]&0x08)?'Running (2nd speed)':'Off');
  $('dZf').textContent=(b[16]&0x40)?'Running':((b[16]&0x20)?'Running (2nd speed)':'Off');
  $('dBk').textContent=(d.ice&&d.ice.full)?'Full':'Not full';
  $('dDf').textContent=(b[17]&0x80)?'Heater on':((b[17]&0x40)?'Cooling hold':'No');
  $('dCm').textContent=['Idle','Fridge','Freezer','Both'][b[17]&3];
  $('dGw').textContent=(b[17]&0x20)?'Linked':'Not linked';
  if(d.ice)$('dIf').textContent=d.ice.n24*7+' cubes, '+d.ice.n24+' batch'+(d.ice.n24==1?'':'es')+(d.ice.ago>=0?' (last '+(d.ice.ep?new Date(d.ice.ep*1000).toLocaleTimeString([],{hour:'numeric',minute:'2-digit'}):ago(d.ice.ago))+')':'');
  $('dInfo').innerHTML='Last message '+ago(q.age)+mq+
    (q.st?"<br><span class='bad'>No fridge data for over "+d.mq.stale+" min - Home Assistant shows the fridge entities as unavailable.</span>":'');
}
function showChg(d){
  const c=d.chg;if(!c)return;
  if(!c.l.length){$('dChg').textContent='No changes seen yet';$('chgTbl').innerHTML='';return;}
  const w=x=>x[1]?dt(x[1]):ago(x[0]);
  const f=c.l[0];
  $('dChg').innerHTML=esc(f[2])+" <span style='font-size:12px;color:#666;font-weight:normal'>("+w(f)+')</span>';
  let h='';
  c.l.forEach(x=>{h+='<tr><td class="tm">'+(x[1]?dtShort(x[1]):ago(x[0]))+'</td><td>'+esc(x[2])+'</td></tr>';});
  $('chgTbl').innerHTML=h;
}
function showKa(d){
  const k=d.ka;if(!k)return;
  if(!kaInit){$('kEn').checked=!!k.en;$('kSec').value=k.sec;kaInit=true;}
  const s='Keepalive: <b>'+(k.en?'ON, every '+k.sec+' s':'off')+'</b> &nbsp;|&nbsp; Sent: '+k.n+(k.ago>=0?' &nbsp;|&nbsp; Last sent: '+ago(k.ago):'')+
    ' &nbsp;|&nbsp; Fridge last answered: '+ago(k.ans);
  $('kStat').innerHTML=s;$('kStatD').innerHTML=s;
}
function showUnk(d){
  const u=d.unk;if(!u)return;
  let h='<tr><th>Item</th><th>Value</th><th>Last changed (since restart)</th></tr>';
  u.i.forEach(x=>{const ch=x[3]>=0;
    h+='<tr><td>'+esc(x[0])+'</td><td class="v">'+esc(x[1])+'</td><td'+(ch?' class="ch"':'')+'>'+(ch?(x[2]?dtShort(x[2]):ago(x[3])):'<span style="color:#888">No change</span>')+'</td></tr>';});
  $('unkTbl').innerHTML=h;
  if(!u.l.length){$('unkLog').innerHTML='<tr><td>None since the monitor restarted.</td></tr>';return;}
  let l='';
  u.l.forEach(x=>{l+='<tr><td class="tm">'+(x[1]?dtShort(x[1]):ago(x[0]))+'</td><td>'+esc(x[2])+'</td></tr>';});
  $('unkLog').innerHTML=l;
}
function showLink(d){
  const l=d.ln;let w='';
  if(l.e>=0&&l.e<15000&&(l.b<0||l.b>l.e+15000))w="<br><span class='bad'>The fridge signal is reaching the pin but the serial port is not receiving it.</span>";
  else if(l.e<0&&!l.lv)w="<br><span class='bad'>No signal seen and the line is LOW: check the signal wire, the ground wire and the level converter.</span>";
  $('lineStat').innerHTML='Signal on the pin: last activity '+ago(l.e)+' (line now '+(l.lv?'HIGH':'LOW')+') &nbsp;|&nbsp; Last byte received: '+ago(l.b)+
    ' &nbsp;|&nbsp; Automatic serial port recoveries: '+l.fix+'<br>Last reset: '+d.rr+w;
  let e='';
  if(d.fe||d.pe||d.ovf)e=" &nbsp;|&nbsp; <span class='bad'>Framing errors: "+d.fe+" &nbsp; Parity errors: "+d.pe+(d.ovf?" &nbsp; Overflows: "+d.ovf+" (port restarts: "+d.rst+")":"")+"</span>";
  else e=' &nbsp;|&nbsp; Framing/parity errors: 0';
  $('stat').innerHTML='<b>'+d.baud+' baud, '+FMTS[d.fmt]+(d.inv?', inverted':'')+'</b> &nbsp;|&nbsp; Bytes received: '+d.bytes+e+
    '<br>RX pin: GPIO '+d.pin+' &nbsp;|&nbsp; Wi-Fi: '+d.rssi+' dBm &nbsp;|&nbsp; Uptime: '+fmtUp(d.up)+' &nbsp;|&nbsp; Bad checksums: '+d.dec.bad;
}
function showCal(d){
  if(!iceInit&&d.ice){$('iFs').value=Math.round(d.ice.fs/30)/2;iceInit=true;}
  if(!calInit&&d.cal){$('oF').value=d.cal.of;$('oZ').value=d.cal.oz;calInit=true;}
  $('cAir').textContent=deg1(d.dec.air);
  $('cFzv').textContent=deg1(d.dec.fz);
}
function showWifi(d){
  if(!mqInit){$('mh').value=d.mq.host;$('mp').value=d.mq.port;$('mu').value=d.mq.user;$('mt').value=d.mq.topic;$('ms').value=d.mq.stale;$('mw').value='';mqInit=true;}
  $('wInfo').innerHTML='Network: <b></b> &nbsp;|&nbsp; IP: '+d.ip+' &nbsp;|&nbsp; Signal: '+d.rssi+' dBm';$('wInfo').querySelector('b').textContent=d.ssid;curSsid=d.ssid;
  $('mStat').innerHTML='MQTT status: '+(d.mq.host?(d.mq.on?'Connected':"<span class='bad'>Disconnected</span>"):'not configured');
}
function syncCtl(d){
  const s=$('baud');
  if(![...s.options].some(o=>+o.value===d.baud))s.add(new Option(d.baud+' (custom)',d.baud));
  s.value=d.baud;$('cbaud').value='';$('fmt').value=d.fmt;$('inv').checked=!!d.inv;$('gap').value=d.gap;
}
function clearView(){$('rows').innerHTML='';prev={};lastT=null;lines=[];}
function addFrame(f){
  const n=f.h.length/2,p=prev[n],hl=$('hl').checked;let hex='',plain='',asc='';
  for(let i=0;i<n;i++){
    const hh=f.h.substr(i*2,2),v=parseInt(hh,16);
    hex+=((hl&&p&&p.substr(i*2,2)!==hh)?'<b>'+hh+'</b>':hh)+' ';
    plain+=hh+' ';
    asc+=(v>=32&&v<127)?String.fromCharCode(v):'.';
  }
  prev[n]=f.h;
  const dl=lastT===null?'':String(f.t-lastT);lastT=f.t;
  const ts=(f.t/1000).toFixed(3);
  const tr=document.createElement('tr');
  [['t',ts],['d',dl],['n',n]].forEach(c=>{const td=document.createElement('td');td.className=c[0];td.textContent=c[1];tr.appendChild(td);});
  const th=document.createElement('td');th.innerHTML=hex;tr.appendChild(th);
  const ta=document.createElement('td');ta.className='a';ta.textContent=asc;tr.appendChild(ta);
  const rows=$('rows');rows.appendChild(tr);
  while(rows.children.length>1000)rows.removeChild(rows.firstChild);
  lines.push(ts+'\t'+dl+'\t'+n+'\t'+plain.trim()+'\t'+asc);
}
async function poll(){
  if(busy)return;busy=true;
  try{
    const ac=new AbortController();const to=setTimeout(()=>ac.abort(),4000);
    const r=await fetch('/data.json'+(PG==='Diag'?'?since='+since:''),{signal:ac.signal});clearTimeout(to);if(!r.ok)return;
    const d=await r.json();lastOk=Date.now();
    $('ver').textContent='v'+d.ver;
    if(PG==='Main'){showDec(d);showChg(d);}
    else if(PG==='Diag'){
      if(d.last<since){since=0;epoch=-1;clearView();return;}
      if(d.epoch!==epoch){epoch=d.epoch;clearView();}
      showDec(d);showLink(d);showKa(d);showUnk(d);
      if(!paused){d.frames.forEach(f=>{if(f.s>since){addFrame(f);since=f.s;}});since=d.last;
        if(d.frames.length&&$('auto').checked){const l=$('log');l.scrollTop=l.scrollHeight;}}
    }
    else if(PG==='Serial'){if(epoch!==d.epoch){epoch=d.epoch;syncCtl(d);}showKa(d);}
    else if(PG==='Wifi')showWifi(d);
    else if(PG==='Cal')showCal(d);
  }catch(e){}
  finally{busy=false;}
}
function post(u,b){return fetch(u,{method:'POST',headers:{'Content-Type':'application/x-www-form-urlencoded'},body:b||''});}
function applySet(){
  const cb=parseInt($('cbaud').value,10);const b=cb>0?cb:$('baud').value;
  post('/set','baud='+b+'&fmt='+$('fmt').value+'&inv='+($('inv').checked?1:0)+'&gap='+$('gap').value).then(()=>{epoch=-1;poll();});
}
function saveKa(){post('/keepalive','en='+($('kEn').checked?1:0)+'&sec='+encodeURIComponent($('kSec').value)).then(()=>{kaInit=false;poll();});}
function saveMqtt(){
  const e=encodeURIComponent;
  post('/save-mqtt','host='+e($('mh').value)+'&port='+e($('mp').value)+'&user='+e($('mu').value)+'&pass='+e($('mw').value)+'&topic='+e($('mt').value)+'&stale='+e($('ms').value))
    .then(()=>{mqInit=false;poll();});
}
function nudge(id,v){const e=$(id);e.value=(Math.round(((parseFloat(e.value)||0)+v)*10)/10).toString();}
function saveIce(){const m=parseFloat($('iFs').value);if(isNaN(m)||m<0||m>30){alert('0 to 30 minutes');return;}post('/ice-cfg','sec='+Math.round(m*60)).then(()=>{iceInit=false;poll();});}
function saveCal(){post('/cal','of='+encodeURIComponent($('oF').value)+'&oz='+encodeURIComponent($('oZ').value)).then(r=>{if(!r.ok)alert('Values must be between -5 and +5');calInit=false;poll();});}
async function wifiScan(start){
  const sel=$('wSel');
  if(start!==false){sel.innerHTML='';sel.add(new Option('Scanning...',''));}
  try{
    const r=await fetch('/wifi-scan.json'+(start!==false?'?start=1':''));const d=await r.json();
    if(d.scanning){clearTimeout(scanTimer);scanTimer=setTimeout(()=>wifiScan(false),1000);return;}
    sel.innerHTML='';
    d.nets.sort((a,b)=>b.r-a.r);
    if(!d.nets.length)sel.add(new Option('No networks found',''));
    d.nets.forEach(n=>{const o=new Option(n.s+'  ('+n.r+' dBm, '+(n.o?'open':'secured')+')'+(n.s===curSsid?'  - current':''),n.s);if(n.s===curSsid)o.selected=true;sel.add(o);});
  }catch(e){clearTimeout(scanTimer);scanTimer=setTimeout(()=>wifiScan(false),2000);}
}
function clearLog(){post('/clear').then(poll);}
function togglePause(){paused=!paused;$('pauseBtn').textContent=paused?'Resume':'Pause';}
function download(){
  const a=document.createElement('a');
  a.href=URL.createObjectURL(new Blob(['Time(s)\tGap(ms)\tLen\tHex\tASCII\n'+lines.join('\n')],{type:'text/plain'}));
  a.download='fridge_capture.txt';a.click();
}
window.addEventListener('load',init);
</script></body></html>
PAGE_SOURCE_END*/
